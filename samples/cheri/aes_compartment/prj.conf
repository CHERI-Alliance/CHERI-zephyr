## CMakeLists.txt
```
# SPDX-License-Identifier: Apache-2.0

cmake_minimum_required(VERSION 3.20.0)

find_package(Zephyr REQUIRED HINTS $ENV{ZEPHYR_BASE})
project(aes_compartment)

target_sources(app PRIVATE src/main.c)
target_sources(app PRIVATE src/compartment_entry.c)
target_sources(app PRIVATE src/attack_entry.c)

zephyr_linker_sources(SECTIONS linker/linker_compartments.ld)

# Pass TEST_NO var from sample.yaml into tests as preprocess var
if(DEFINED TEST_NO)
    zephyr_compile_definitions(TEST_NO=${TEST_NO})
endif()

# The external static library that we are linking with does not know
# how to build for this platform so we export all the flags used in
# this zephyr build to the external build system.
#
# Other external build systems may be self-contained enough that they
# do not need any build information from zephyr. Or they may be
# incompatible with certain zephyr options and need them to be
# filtered out.
zephyr_get_include_directories_for_lang_as_string(       C includes)
zephyr_get_system_include_directories_for_lang_as_string(C system_includes)
zephyr_get_compile_definitions_for_lang_as_string(       C definitions)
zephyr_get_compile_options_for_lang_as_string(           C options)

if(DEFINED CMAKE_C_COMPILER_TARGET)
  set(target_flag "--target=${CMAKE_C_COMPILER_TARGET}")
endif()

#set(set_captable_scope_file "-Wl,-captable-scope=file")

set(external_project_cflags
    #"${target_flag} ${set_captable_scope_file} ${includes} ${definitions} ${options} ${system_includes}"
  "${target_flag} ${includes} ${definitions} ${options} ${system_includes}"
  )



# Create variables for mabi/march to pass on to library's makefile
if(CONFIG_64BIT)
    set(AESLIB_MARCH rv64imafdzcheripurecap)
    set(AESLIB_MABI l64pc128d)
else()
    set(AESLIB_MARCH rv32imafdzcheripurecap)
    #set(AESLIB_MABI il32pc64d)
    set(AESLIB_MABI il32pc64)
endif()

include(ExternalProject)

# Add an external project to be able download and build the third
# party library. In this case downloading is not necessary as it has
# been committed to the repository.
set(aeslib_src_dir   ${CMAKE_CURRENT_SOURCE_DIR}/aeslib)
set(aeslib_build_dir ${CMAKE_CURRENT_BINARY_DIR}/aeslib)

set(AESLIB_LIB_DIR     ${aeslib_build_dir}/lib)
set(AESLIB_INCLUDE_DIR ${aeslib_src_dir}/include)

if(CMAKE_GENERATOR STREQUAL "Unix Makefiles")
# https://www.gnu.org/software/make/manual/html_node/MAKE-Variable.html
set(submake "$(MAKE)")
else() # Obviously no MAKEFLAGS. Let's hope a "make" can be found somewhere.
set(submake "make")
endif()

# This setting breaks the delicate linker maniuplations required to manually set
# up compartments
STRING(REGEX REPLACE "-msmall-data-limit=0" "" external_project_cflags ${external_project_cflags})

ExternalProject_Add(
  aeslib_project                # Name for custom target
  PREFIX     ${aeslib_build_dir} # Root dir for entire project
  SOURCE_DIR ${aeslib_src_dir}
  BINARY_DIR ${aeslib_src_dir} # This particular build system is invoked from the root
  CONFIGURE_COMMAND ""    # Skip configuring the project, e.g. with autoconf
  BUILD_COMMAND
  ${submake}
  PREFIX=${aeslib_build_dir}
  CC=${CMAKE_C_COMPILER}
  AR=${CMAKE_AR}
  # pass appropriate MARCH/MABI
  MARCH=${AESLIB_MARCH}
  MABI=${AESLIB_MABI}
  CFLAGS=${external_project_cflags}
  INSTALL_COMMAND ""      # This particular build system has no install command
  BUILD_BYPRODUCTS ${AESLIB_LIB_DIR}/lib_chericompartment1_aeslib.a
  )

# Create a wrapper CMake library that our app can link with
add_library(aeslib_lib STATIC IMPORTED GLOBAL)
add_dependencies(
  aeslib_lib
  aeslib_project
  )
set_target_properties(aeslib_lib PROPERTIES IMPORTED_LOCATION
    ${AESLIB_LIB_DIR}/lib_chericompartment1_aeslib.a)
set_target_properties(aeslib_lib PROPERTIES INTERFACE_INCLUDE_DIRECTORIES ${AESLIB_INCLUDE_DIR})

target_link_libraries(app PUBLIC aeslib_lib)
```

## sample.yaml
```
sample:
  name: AES Compartment Demonstration
  description: show how to manually constuct CHERI compartments on zephyr
common:
  tags: cheri
  toolchain_allow:
    - llvm-cheri
  platform_allow:
    - qemu_riscv64cheri_zcheripurecap
    - qemu_riscv64cheri_smp_zcheripurecap
  harness: console
  harness_config:
    type: one_line
    regex:
      - "Test Complete"

tests:
  samples.cheri.aes_compartment.test1:
    extra_args: TEST_NO=1
  samples.cheri.aes_compartment.test2:
    extra_args: TEST_NO=2
  samples.cheri.aes_compartment.test3:
    extra_args: TEST_NO=3
  samples.cheri.aes_compartment.test4:
    extra_args: TEST_NO=4
  samples.cheri.aes_compartment.test5:
    extra_args: TEST_NO=5
  samples.cheri.aes_compartment.test6:
    extra_args: TEST_NO=6
```

## prj.conf
```kconfig
CONFIG_STDOUT_CONSOLE=y
CONFIG_PRINTK=y
CONFIG_LOG=y
CONFIG_LOG_MODE_MINIMAL=y

CONFIG_ASSERT=y
CONFIG_USERSPACE=y
CONFIG_RISCV_CHERI_USERCAPS_POC=y
CONFIG_RISCV_PMP=n
CONFIG_HW_STACK_PROTECTION=n
```

## src/main.c
```c
/*
 * Copyright (c) 2026 University of Birmingham, Added to support CHERI spec
 *
 * SPDX-License-Identifier: Apache-2.0
 */

#include <zephyr/kernel.h>

#include <stdio.h>
#include <string.h>
#include <stdint.h>

#include "inline_funcs.h"
#include "compartment_interface.h"	/* table for compartment interfacing */
#include "compartment_entry.h"		/* def of compartment funcs - only 1 */

/* Attacker compartment details */
#include "attack_interface.h"
#include "attack_entry.h"

/* enable ECB mode */
#define ECB 1
#define ENCRYPT 1
#define DECRYPT 2

#define USER_STACKSIZE 2048

/* kernel thread PCC bounds defined in linker and set at boot */
extern uintptr_t __start;
extern uintptr_t _end;

/* Create the thread / stack for a compartment
 *
 * At the moment, these must be defined globally; we could create one for each
 * test / compartment, but as they only ever run singly, it's okay to use one
 * for every test.
 */
struct k_thread compartment_thread;
K_THREAD_STACK_DEFINE(compartment_stack, USER_STACKSIZE);

/* compartment bounds extracted from linker script */
extern char __compartment1_start[];
extern char __compartment1_end[];

/* Attacker bounds extract from linker script */
extern char __compartment2_start[];
extern char __compartment2_end[];

static struct entry_caps aes_interface_table;
static struct attack_caps attack_interface_table;

/* Location of compartment information (in this case, the AES sbox) which we
 * 'leak' here to demonstrate how accessing this data is impossible from
 * another container.
 */
extern char __sbox_loc;

/* Borrowed from tiny-AES's test_encrypt_ecb for 128 bit */
const uint8_t in[] = {0x6b, 0xc1, 0xbe, 0xe2, 0x2e, 0x40, 0x9f, 0x96,
			  0xe9, 0x3d, 0x7e, 0x11, 0x73, 0x93, 0x17, 0x2a};
const uint8_t key[] = {0x2b, 0x7e, 0x15, 0x16, 0x28, 0xae, 0xd2, 0xa6,
			   0xab, 0xf7, 0x15, 0x88, 0x09, 0xcf, 0x4f, 0x3c};
const uint8_t out[] = {0x3a, 0xd7, 0x7b, 0xb4, 0x0d, 0x7a, 0x36, 0x60,
			   0xa8, 0x9e, 0xca, 0xf3, 0x24, 0x66, 0xef, 0x97};
const size_t msg_size = sizeof(in);
const size_t key_size = sizeof(key);
const size_t out_size = sizeof(out);

/*** standard zephyr return code for exception ***/

/* This is called after the kernel’s internal fault processing.
 * This allows you to print and complete the sample
 * after a CHERI hardware exception.
 */
void k_sys_fatal_error_handler(unsigned int reason, const struct arch_esf *esf)
{
	printk(">>> %s: reason=%u esf=%p\n", __func__, reason, esf);

	if (reason == 0) {
		printk("CPU CHERI hardware exception!\n");

/* Test 3 and 6 are supposed to emit a memory protection error */
#if TEST_NO == 3
		printk("Test Complete\n");
#elif TEST_NO == 6
		printk("Test Complete\n");
#endif

	} else {
		printk("Sample finished\n");
	}

	/* halt forever, DO NOT RETURN */
	for (;;) {
		k_busy_wait(1000000);
	}
}
/*** end standard zephyr return code for exception ***/

/* simple wrapper around k_thread_create.
 *  arg1: interface_ptr (struct with objects /functions for the compartment
 *  arg2: integer (used to indicate encryption/decryption; used for tests 1-3
 *  arg3: pointer to a leaked address in one of the compartment; used for
 *		  tests 5/6
 */
void start_compartment(void *compartment_entry, void *interface_ptr, int arg1, uintptr_t *arg2)
{

	printk(">> Leaving main...\n");
	/* Create a (userspace) thread for the compartment.
	 *
	 * We use zephyr's userspace threads feature for our compartments; these
	 * will natively take advantage of CHERI's hardware to provide isolation
	 * on cheri zephyr systems.
	 *
	 */
	k_tid_t tid = k_thread_create(&compartment_thread, compartment_stack, USER_STACKSIZE,
					  compartment_entry, interface_ptr, &arg1, arg2, -1, K_USER,
					  K_MSEC(0));

	k_thread_join(tid, K_FOREVER);
	printk("<< back in main...\n");
}

/* helper method to shrink a capability to new bounds */
void *shrink_fptr(void *func, uintptr_t bound_low, uintptr_t bound_high)
{
	print_cap("bounds before reduction", func);

	/* Use the pcc to derive a new cap for the compartment */
	void *pcc = __builtin_cheri_program_counter_get();
	void *compartment_cap = __builtin_cheri_address_set(pcc, bound_low);

	/* Create a new cap which stores the proper bounds */
	size_t compartment_len = bound_high - bound_low;

	compartment_cap = __builtin_cheri_bounds_set(compartment_cap, compartment_len);

	/* Apply these bounds to the func that was passed in */
	void *bounded_func = __builtin_cheri_address_set(compartment_cap, (uintptr_t)func);

	print_cap("bounds after reduction", bounded_func);
	return bounded_func;
}

/* helper function to print array as hex; assumes AES128 */
void phex(uint8_t *str)
{
	uint8_t len = 16;

	unsigned char i;

	for (i = 0; i < len; ++i) {
		printk("%.2x", str[i]);
	}
	printk("\n");
}

/* summarize AES test */
bool test_results(struct entry_caps *aes_interface_table, const uint8_t *in, const uint8_t *out)
{

	printk("\n");
	printk("key:               ");
	for (int i = 0; i < aes_interface_table->keysize; ++i) {
		printk("%.2x", aes_interface_table->key[i]);
	}
	printk("\n");
	printk("in:                ");
	for (int i = 0; i < aes_interface_table->insize; ++i) {
		printk("%.2x", in[i]);
	}

	printk("\nEncryption result: ");
	for (int i = 0; i < aes_interface_table->outsize; ++i) {
		printk("%.2x", aes_interface_table->out[i]);
	}
	printk("\n");
	printk("Ground truth:      ");
	for (int i = 0; i < aes_interface_table->outsize; ++i) {
		printk("%.2x", out[i]);
	}
	printk("\n");

	/* test buffout matches gt */
	return (0 == memcmp((char *)aes_interface_table->out, (char *)out,
				aes_interface_table->outsize));
}

/* 1. call compartment WITHOUT reduced bounds - not a proper compartment */
void test1(struct entry_caps aes_interface_table)
{
	printk("Test 1/6: Testing encryption: full bounds - no restrictions!\n");

	/* print out current bounds info of our compartment */
	print_cap("AES library compartment bounds *before* reduction", entry);

	/* run compartment without restricting bounds */
	start_compartment(entry, &aes_interface_table, ENCRYPT, 0);

	/* Test if the AES encryption was done properly */
	bool outcome = test_results(&aes_interface_table, in, out);

	if (outcome) {
		printk("Test Complete\n");
	} else {
		printk("Test FAILED\n");
	}
}

/* 2. call compartment WITH reduced bounds */
void test2(struct entry_caps aes_interface_table)
{
	printk("Test 2/6: Testing encryption with restricted bounds - full isolation!\n");

	/* Now, reduce the bounds to the size of the compartment
	 *
	 * For experiments 2, 3, and 4, we use entry_bounded instead of
	 * entry for isolation.
	 */
	printk("Reducing library compartment bounds...\n");
	void *entry_bounded =
		shrink_fptr(entry, (uintptr_t)__compartment1_start, (uintptr_t)__compartment1_end);

	/* start the compartment */
	start_compartment(entry_bounded, &aes_interface_table, ENCRYPT, 0);

	/* Test if the AES encryption was done properly */
	bool outcome = test_results(&aes_interface_table, in, out);

	if (outcome) {
		printk("Test Complete\n");
	} else {
		printk("Test FAILED\n");
	}
}

/* 3. Demonstrate that compartments, once properly bounded, can't 'reach
 *	outside' their bounds, eg, to access a global variable. This function is
 *	the same as the last one but a conditional in the compartment code will
 *	attempt to access a variable outside the bounds of the compartment.
 */
void test3(struct entry_caps aes_interface_table)
{
	printk("Test 3/6: Testing trying to access outside a compartment!\n");

	/* Again, reduce the bounds to the size of the compartment */
	printk("Reducing library compartment bounds...\n");
	void *entry_bounded =
		shrink_fptr(entry, (uintptr_t)__compartment1_start, (uintptr_t)__compartment1_end);

	/* start the compartment */
	start_compartment(entry_bounded, &aes_interface_table, ENCRYPT, 0);

	/* Test if the AES encryption was done properly */
	bool outcome = test_results(&aes_interface_table, in, out);

	if (outcome) {
		printk("Test Complete\n");
	} else {
		printk("Test FAILED\n");
	}
}

/* 4: Test decryption with reduced bounds */
void test4(struct entry_caps aes_interface_table)
{
	printk("Test 4/6: Testing decryption with restricted bounds - full isolation!\n");

	/* Again, reduce the bounds to the size of the compartment */
	printk("Reducing library compartment bounds...\n");
	void *entry_bounded =
		shrink_fptr(entry, (uintptr_t)__compartment1_start, (uintptr_t)__compartment1_end);

	/* RESET the aes_interface_table; now 'out' is swapped with in
	 * because we're decrypting.
	 */
	uint8_t in_dyn[16] = {0};
	uint8_t out_dyn[16] = {0};

	memcpy(in_dyn, out, msg_size);
	memset(out_dyn, 0, out_size);
	aes_interface_table.in = in_dyn;
	aes_interface_table.out = out_dyn;

	/* start the compartment */
	start_compartment(entry_bounded, &aes_interface_table, DECRYPT, 0);

	/* Test if the AES decryption was done properly
	 *
	 * Here, out and in are flipped to test decryption
	 */
	bool outcome = test_results(&aes_interface_table, out, in);

	if (outcome) {
		printk("Test Complete\n");
	} else {
		printk("Test FAILED\n");
	}
}

/* 5. Now, simulate a malicious 'attack compartment' that tries to 'reach in'
 * to another compartment's memory.  This will succeced because the bounds for
 * this second compartment haven't been shrunk.
 */
void test5(struct attack_caps attack_interface_table)
{
	printk("Test 5/6: Testing attacker compartment: full bounds - no restrictions!\n");

	uintptr_t sbox_loc = (uintptr_t)&__sbox_loc;

	/* start the compartment */
	start_compartment(attack_entry, &attack_interface_table, 0, &sbox_loc);

	/* Demonstrate we were able to extract the secret data */
	printk("First 4 byte of AES compartment private data (sbox): ");
	printk("%.2x %.2x %.2x %.2x...\n", attack_interface_table.out[0],
		   attack_interface_table.out[1], attack_interface_table.out[2],
		   attack_interface_table.out[3]);
	printk("Test Complete\n");
}

/* 6. Finally, simulate how the malicious compartment is blocked from 'reaching
 *	in' to the memory of the other compartment when its bounds are properly
 *	reduced. This compartment will encounter a memory protection error as it
 *	starts to exfiltrate and end up in k_sys_fatal_error_handler().
 */
void test6(struct attack_caps attack_interface_table)
{
	printk("Test 6/6: Testing attacker compartment: restricted bounds - full isolation!\n");

	uintptr_t sbox_loc = (uintptr_t)&__sbox_loc;

	printk("Reducing attack compartment bounds...\n");
	void *attack_bounded = shrink_fptr(attack_entry, (uintptr_t)__compartment2_start,
					   (uintptr_t)__compartment2_end);

	/* start the compartment */
	start_compartment(attack_bounded, &attack_interface_table, 0, &sbox_loc);

	/* Demonstrate we were able to extract the secret data */
	printk("First 4 byte of AES compartment private data (sbox): ");
	printk("%.2x %.2x %.2x %.2x...\n", attack_interface_table.out[0],
		   attack_interface_table.out[1], attack_interface_table.out[2],
		   attack_interface_table.out[3]);

	/* This test SHOULD cause a memory protection error */
	printk("Test FAILED\n");
}

int main(void)
{
	printk("\nCHERI AES (128) compartment test on %s\n", CONFIG_BOARD_TARGET);

	/* Sanity check current pcc / bounds */
	printk("%s kernel pcc bounds __start: 0x%lx\n", __func__, (unsigned long)&__start);
	printk("%s kernel pcc bounds _end: 0x%lx\n", __func__, (unsigned long)&_end);
	print_cap(__func__, main); /* after CHERI rounding top may be > _end */

	/* populate aes_interface_table for passing caps to compartment;
	 * This is necessary in this manual PoC.
	 */
	printk("Set up interface tables for interfacing with the compartment...");

	/* pass a copy of 'in' so we preserve the original value */
	uint8_t in_dyn[16] = {0};
	uint8_t out_dyn[16] = {0};

	memcpy(in_dyn, in, msg_size);
	memset(out_dyn, 0, out_size);

	/* Setup the table */
	aes_interface_table.in = in_dyn;
	aes_interface_table.insize = msg_size;
	aes_interface_table.key = key;
	aes_interface_table.keysize = key_size;
	aes_interface_table.out = out_dyn;
	aes_interface_table.outsize = out_size;

	/* setup the attack interface table */
	attack_interface_table.memcpy_cap = memcpy;

	/* SETUP DONE */
	printk("done\n\n");

	/* execute the appropriate test */
#if TEST_NO == 1
	test1(aes_interface_table);
#elif TEST_NO == 2
	test2(aes_interface_table);
#elif TEST_NO == 3
	test3(aes_interface_table);
#elif TEST_NO == 4
	test4(aes_interface_table);
#elif TEST_NO == 5
	test5(attack_interface_table);
#elif TEST_NO == 6
	test6(attack_interface_table);
#else
	/* default to test2 to show shrinking bounds */
	test2(aes_interface_table);
#endif

	return 0;
}
```

## src/attack_entry.c
```c
/*
 * Copyright (c) 2026 University of Birmingham, Added to support CHERI spec
 *
 * SPDX-License-Identifier: Apache-2.0
 */

#include "attack_entry.h"
#include "attack_interface.h"

/* here we manually define the section the compartment will reside */
[[gnu::section(".compartment2.entry"), gnu::aligned(512)]]
void attack_entry(void *p1, void *p2, void *p3)
{
	struct attack_caps *caps = p1;

	/* re-derive a capability based on the location of the
	 * sbox (in the other compartment)
	 */
	void *pcc = __builtin_cheri_program_counter_get();
	void *sbox_cap = __builtin_cheri_address_set(pcc, *(uintptr_t *)p3);
	uint8_t *sbox = (uint8_t *)sbox_cap;

	/* Note that if the location of the sbox is outside pcc,
	 * as it is in test #5, we'll see a capability like, eg:

	   (gdb) print sbox
	   $7 = (volatile uint8_t *) 0x800258c0 [V:1111:C:r.xCal..:0:.:0x80026800-0x8002681c] <snip>

	 * Note that the value of the captability is outside the bounds
	 * Trying to exfiltrate the sbox will fail, in this case with a memory
	 * protection error.
	 */

	/* (Attempt to) exfiltrate the sbox */
	caps->memcpy_cap(caps->out, sbox, 256);
}
```

## src/attack_entry.h
```c
/*
 * Copyright (c) 2026 University of Birmingham, support for CHERI
 *
 * SPDX-License-Identifier: Apache-2.0
 */

[[gnu::section(".compartment2.entry"), gnu::aligned(512)]]
void attack_entry(void *p1, void *p2, void *p3);
```

## src/attack_interface.h
```c
/*
 * Copyright (c) 2026 University of Birmingham, support for CHERI
 *
 * SPDX-License-Identifier: Apache-2.0
 */
#include <zephyr/kernel.h>
#include "aeslib.h"

struct attack_caps {

	/* Give the attacker access to memcpy */
	void *(*memcpy_cap)(void *dst, const void *src, size_t size);

	/* Give the attacker an output sink */
	uint8_t out[256];
};
```

## src/compartment_entry.c
```c
/*
 * Copyright (c) 2026 University of Birmingham, Added to support CHERI spec
 *
 * SPDX-License-Identifier: Apache-2.0
 */

#include "compartment_interface.h"
#include "compartment_entry.h"
#include "aeslib.h"

volatile int OOB_TEST = 64;

/* here we manually define the section the compartment will reside */
[[gnu::section(".compartment1.entry"), gnu::aligned(512)]]
void entry(void *p1, void *p2, void *p3)
{
	struct entry_caps *caps = p1;
	int mode = *(int *)p2;

	/* Demonstrate thread-local stack works */
	volatile int omg = 6;

#if TEST_NO == 3
	/* any accesses OUTSIDE the compartment, e.g. to global variables like
	 * OOB_TEST will cause a memory protection error.
	 */
	omg += OOB_TEST;
#endif

	/* perform the appropriate AES operation */
	struct AES_ctx ctx;

	AES_init_ctx(&ctx, caps->key);

	if (mode == 1) {
		AES_ECB_encrypt(&ctx, caps->in);
	} else if (mode == 2) {
		AES_ECB_decrypt(&ctx, caps->in);
	}

	/* Move the data out */
	for (int i = 0; i < caps->insize; ++i) {
		caps->out[i] = caps->in[i];
	}
}
```

## src/compartment_entry.h
```c
/*
 * Copyright (c) 2026 University of Birmingham, support for CHERI
 *
 * SPDX-License-Identifier: Apache-2.0
 */


[[gnu::section(".compartment1.entry"), gnu::aligned(512)]]
void entry(void *p1, void *p2, void *p3);
```

## src/compartment_interface.h
```c
/*
 * Copyright (c) 2026 University of Birmingham, support for CHERI
 *
 * SPDX-License-Identifier: Apache-2.0
 */
#include <zephyr/kernel.h>
#include "aeslib.h"

struct entry_caps {

	/* Designed for AES ECB mode */
	uint8_t *in;
	int8_t insize;
	const uint8_t *key;
	int8_t keysize;
	uint8_t *out;
	int8_t outsize;
};
```

## src/inline_funcs.h
```c
/*
 * Copyright (c) 2026 University of Birmingham, support for CHERI
 *
 * SPDX-License-Identifier: Apache-2.0
 */

#include <zephyr/kernel.h>

/* CHERI helper function for printing inline */

static inline void print_cap(const char *label, void *cap)
{
#ifdef __CHERI_PURE_CAPABILITY__
	uintptr_t cap_addr = __builtin_cheri_address_get(cap);
	uintptr_t cap_base = __builtin_cheri_base_get(cap);
	size_t cap_len  = __builtin_cheri_length_get(cap);
	size_t tag = __builtin_cheri_tag_get(cap);
	size_t sealed = __builtin_cheri_sealed_get(cap);

	printk("%s\n", label);
	printk("\tCHERI addr:   0x%lx\n", (unsigned long)cap_addr);
	printk("\tCHERI base:   0x%lx\n", (unsigned long)cap_base);
	printk("\tCHERI top:    0x%lx\n", (unsigned long)cap_base+cap_len);
	printk("\tCHERI length: %zu\n", cap_len);
	printk("\tCHERI tag:    %zu\n", tag);
	printk("\tCHERI sealed: %zu (%s)\n",
		sealed,
		sealed ? "sealed" : "unsealed");

#endif /* __CHERI_PURE_CAPABILITY__ */
}
```
