## CMakeLists.txt
```
# SPDX-License-Identifier: Apache-2.0

cmake_minimum_required(VERSION 3.20.0)

find_package(Zephyr REQUIRED HINTS $ENV{ZEPHYR_BASE})
project(stack_overflow)

target_sources(app PRIVATE src/main.c)
```

## sample.yaml
```
sample:
  description: CHERI showing hardware exception
  name: CHERI stack overflow
common:
  tags: cheri
  harness: console
  harness_config:
    type: one_line
    regex:
      - "Sample finished"
tests:
  samples.cheri.stack_overflow:
    tags: cheri
    toolchain_allow:
      - llvm-cheri
    platform_allow:
      - qemu_riscv64cheri
      - qemu_riscv32cheri
      - qemu_riscv64cheri_purecap
      - qemu_riscv32cheri_purecap
      - qemu_riscv64cheri_zcheripurecap
      - qemu_riscv32cheri_zcheripurecap
      - qemu_riscv64cheri_smp_purecap
      - qemu_riscv32cheri_smp_purecap
      - qemu_riscv64cheri_smp_zcheripurecap
      - qemu_riscv32cheri_smp_zcheripurecap
```

## prj.conf
```kconfig
CONFIG_PRINTK=y
CONFIG_INIT_STACKS=y
CONFIG_TRACING=y

# This only works for 32 bit, 64 bit overloads logging
# Make sure console is available and immediate
#CONFIG_LOG=y
#CONFIG_LOG_MODE_IMMEDIATE=y
```

## src/main.c
```c
/*
 * Copyright (c) 2026 University of Birmingham, Added to support CHERI spec
 *
 * SPDX-License-Identifier: Apache-2.0
 */

#include <zephyr/kernel.h>
#include "inline_funcs.h"

/* Stack to provoke overflow */
#define OVERFLOW_STACK_SIZE 2048
/* Size of stack memory to inspect (must be > OVERFLOW_STACK_SIZE) */
#define OVERFLOW_BYTES OVERFLOW_STACK_SIZE + 4096

K_THREAD_STACK_DEFINE(overflow_stack, OVERFLOW_STACK_SIZE);
static struct k_thread overflow_thread;

/* This is called after the kernel’s internal fault processing.
 * This allows you to print and return to main afterwards
 * Also use this because the 64-bit CHERI overloads the logging message on exception
 */
void k_sys_fatal_error_handler(unsigned int reason, const struct arch_esf *esf)
{
	printk(">>> %s: reason=%u esf=%p\n", __func__, reason, esf);

	if (reason == 0) {
		printk("CPU CHERI hardware exception!\n");
	}
	printk("Sample finished\n");

	/* halt forever, DO NOT RETURN */
	for (;;) {
		k_busy_wait(1000000);
	}
}

/* thread entry function */
void overflow_entry(void *a, void *b, void *c)
{
	printk("Inside thread entry function\n");

	/* get stack pointer */
	void *sp;

#ifdef __CHERI_PURE_CAPABILITY__
	__asm__ volatile(STRINGIFY(M_CMOVE)" %0, csp" : "=C"(sp) :: "memory");
	print_cheri("Thread capability stack pointer (CSP):\n", sp);
#else
	__asm__ volatile("mv %0, sp" : "=r"(sp));
	printk("Thread stack pointer (SP) : %p\n", sp);
#endif
	/* Create a derived pointer and walk outside bounds */
	char *p = (char *)sp;

	/* CHERI will trap when i exceeds CSP bounds */
	for (int i = 0; i < OVERFLOW_BYTES; i++) {
		char val = p[i];

		printk("reading stack[%d] @ %p -> 0x%02x\n", i, (void *)&p[i], val);
	}
	printk("Stack Overflow - read past the end of the stack!\n");
	/* End the thread to avoid looping */
	k_thread_abort(k_current_get());
}

int main(void)
{
	printk("\nRunning CHERI stack overflow sample on %s\n", CONFIG_BOARD_TARGET);

	size_t stack_size = K_THREAD_STACK_SIZEOF(overflow_stack);

	printk("stack size= %zu bytes, overflow bytes= %zu\n",
		stack_size, (size_t)OVERFLOW_BYTES);

	/* Create the thread stack. */
	k_tid_t tid = k_thread_create(
	&overflow_thread,
	overflow_stack,
	stack_size,
	overflow_entry,
	NULL, NULL, NULL,
	0,
	0,
	K_NO_WAIT
	);

	/*
	 * Wait for it to finish/fault. If a bounds fault occurs, the kernel will
	 * log a trap and terminate the thread.
	 */
	k_thread_join(tid, K_FOREVER);

	printk("returned to %s\n", __func__);
	printk("Sample finished\n");
	return 0;
}
```

## src/inline_funcs.h
```c
/*
 * Copyright (c) 2026 University of Birmingham, support for CHERI
 *
 * SPDX-License-Identifier: Apache-2.0
 */

#include <zephyr/kernel.h>

/* CHERI helper function for printing inline */

static inline void print_cheri(const char *label, void *cap)
{
#ifdef __CHERI_PURE_CAPABILITY__
	uintptr_t cap_addr = __builtin_cheri_address_get(cap);
	uintptr_t cap_base = __builtin_cheri_base_get(cap);
	size_t cap_len  = __builtin_cheri_length_get(cap);
	size_t tag = __builtin_cheri_tag_get(cap);

	printk("%s", label);
	printk("CHERI addr:   0x%lx\n", (unsigned long)cap_addr);
	printk("CHERI base:   0x%lx\n", (unsigned long)cap_base);
	printk("CHERI top:   0x%lx\n", (unsigned long)cap_base+cap_len);
	printk("CHERI length: %zu\n", cap_len);
	printk("CHERI tag: %zu\n", tag);
	printk("bytes before end of stack: %lu\n", (unsigned long)(cap_base+cap_len-cap_addr));
#endif /* __CHERI_PURE_CAPABILITY__ */
}
```
