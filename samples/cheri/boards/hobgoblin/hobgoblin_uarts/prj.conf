## CMakeLists.txt
```
# SPDX-License-Identifier: Apache-2.0

cmake_minimum_required(VERSION 3.20.0)

find_package(Zephyr REQUIRED HINTS $ENV{ZEPHYR_BASE})
project(hobgoblin_uarts)

target_sources(app PRIVATE src/main.c)

if(CHERI_TEST_UART_INTERRUPTS)
  target_compile_definitions(app PRIVATE CHERI_TEST_UART_INTERRUPTS)
endif()
```

## sample.yaml
```
sample:
  description: sample different uarts on hobgoblin platform
  name: hobgoblin_uarts
common:
  tags: cheri
  harness: console
  harness_config:
    type: one_line
    regex:
      - "UART test (.*)"
tests:
  samples.cheri.hobgoblin_uarts_uart0_poll:
    tags: cheri
    build_only: true
    toolchain_allow:
      - llvm-cheri
    platform_allow:
      - hobgoblin_riscv32cheri
      - hobgoblin_riscv64cheri
      - hobgoblin_riscv32cheri_zcheripurecap
      - hobgoblin_riscv64cheri_zcheripurecap
  samples.cheri.hobgoblin_uarts_uart0_interrupts:
    tags: cheri
    extra_args:
      - CHERI_TEST_UART_INTERRUPTS=ON
    build_only: true
    toolchain_allow:
      - llvm-cheri
    platform_allow:
      - hobgoblin_riscv32cheri
      - hobgoblin_riscv64cheri
      - hobgoblin_riscv32cheri_zcheripurecap
      - hobgoblin_riscv64cheri_zcheripurecap
  samples.cheri.hobgoblin_uarts_uart1_poll_64:
    tags: cheri
    extra_args:
      - DTC_OVERLAY_FILE=${ZEPHYR_BASE}/boards/codasip/hobgoblin_riscv64cheri/uart1.overlay
    build_only: true
    toolchain_allow:
      - llvm-cheri
    platform_allow:
      - hobgoblin_riscv64cheri
      - hobgoblin_riscv64cheri_zcheripurecap
  samples.cheri.hobgoblin_uarts_uart1_poll_32:
    tags: cheri
    extra_args:
      - DTC_OVERLAY_FILE=${ZEPHYR_BASE}/boards/codasip/hobgoblin_riscv32cheri/uart1.overlay
    build_only: true
    toolchain_allow:
      - llvm-cheri
    platform_allow:
      - hobgoblin_riscv32cheri
      - hobgoblin_riscv32cheri_zcheripurecap
  samples.cheri.hobgoblin_uarts_uart1_interrupts_64:
    tags: cheri
    extra_args:
      - DTC_OVERLAY_FILE=${ZEPHYR_BASE}/boards/codasip/hobgoblin_riscv64cheri/uart1.overlay
      - CHERI_TEST_UART_INTERRUPTS=ON
    build_only: true
    toolchain_allow:
      - llvm-cheri
    platform_allow:
      - hobgoblin_riscv64cheri
      - hobgoblin_riscv64cheri_zcheripurecap
  samples.cheri.hobgoblin_uarts_uart1_interrupts_32:
    tags: cheri
    extra_args:
      - DTC_OVERLAY_FILE=${ZEPHYR_BASE}/boards/codasip/hobgoblin_riscv32cheri/uart1.overlay
      - CHERI_TEST_UART_INTERRUPTS=ON
    build_only: true
    toolchain_allow:
      - llvm-cheri
    platform_allow:
      - hobgoblin_riscv32cheri
      - hobgoblin_riscv32cheri_zcheripurecap
```

## prj.conf
```kconfig
CONFIG_CONSOLE=y
CONFIG_UART_CONSOLE=y
CONFIG_CONSOLE_SUBSYS=y
CONFIG_CONSOLE_GETLINE=y
CONFIG_CONSOLE_GETCHAR=y
CONFIG_PRINTK=y
CONFIG_LOG=y
CONFIG_LOG_MODE_MINIMAL=y
```

## src/main.c
```c
/*
 * Copyright (c) 2026 University of Birmingham, Added to support CHERI spec
 *
 * SPDX-License-Identifier: Apache-2.0
 */

#include <stdio.h>
#include <zephyr/kernel.h>
#include <zephyr/console/console.h>
#include <zephyr/sys/printk.h>
#include <zephyr/drivers/uart.h>
#include <zephyr/device.h>


#ifdef CHERI_TEST_UART_INTERRUPTS
/* call back function for testing uart with interrupts */
static void uart_cb(const struct device *dev, void *user_data)
{
	uint8_t c;

	uart_irq_update(dev);

	while (uart_irq_rx_ready(dev)) {
		while (uart_fifo_read(dev, &c, 1)) {
			printk("RX: %c\n", c);
		}
	}
}
#endif

void main(void)
{

#ifndef CHERI_TEST_UART_INTERRUPTS
/* Use polling to read in characters from the uart console and print */
	const struct device *dev =
		DEVICE_DT_GET(DT_CHOSEN(zephyr_console));

	printf("UART test for %s\n", CONFIG_BOARD_TARGET);
	printf("Enter some characters for polling\n\n");

	if (!device_is_ready(dev)) {
		printf("console device not ready\n");
	return;
	}

	while (1) {
		unsigned char c;

		if (uart_poll_in(dev, &c) == 0) {
			printf("RX: %c\n", c);
		}
	}
#endif

#ifdef CHERI_TEST_UART_INTERRUPTS
/* Use interrupts to read in characters from the uart console and print */
	const struct device *dev =
		DEVICE_DT_GET(DT_CHOSEN(zephyr_console));

	printf("UART test for %s\n", CONFIG_BOARD_TARGET);
	printf("Enter some characters using interrupts\n\n");

	if (!device_is_ready(dev)) {
		printk("console device not ready\n");
	return;
	}

	int ret = uart_irq_callback_user_data_set(dev, uart_cb, NULL);

	uart_irq_rx_enable(dev);

	while (1) {
		k_sleep(K_FOREVER);
	}
#endif
}
```
