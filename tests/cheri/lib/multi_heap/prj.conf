## CMakeLists.txt
```
# SPDX-License-Identifier: Apache-2.0

cmake_minimum_required(VERSION 3.20.0)
find_package(Zephyr REQUIRED HINTS $ENV{ZEPHYR_BASE})
project(cheri_multi_heap)

FILE(GLOB app_sources src/*.c)
target_sources(app PRIVATE ${app_sources})

target_include_directories(app PRIVATE
  ${ZEPHYR_BASE}/kernel/include
  ${ZEPHYR_BASE}/arch/${ARCH}/include
  )
```

## prj.conf
```kconfig
CONFIG_ZTEST=y
CONFIG_HEAP_MEM_POOL_SIZE=1024
CONFIG_MULTI_HEAP=y
```

## src/main.c
```c
/*
 * Copyright (c) 2026 University of Birmingham, added to support CHERI tests
 *
 * SPDX-License-Identifier: Apache-2.0
 */

#include <zephyr/ztest.h>

/**
 * @brief Heap tests with CHERI
 *
 * @defgroup cheri_k_heap_api_tests CHERI Heap Memory Tests
 *
 * @ingroup cheri_tests
 *
 * This complements the tests in
 * tests/lib/multi-heap but are more CHERI-specific.
 */

/*test case main entry*/
ZTEST_SUITE(cheri_mheap_api, NULL, NULL, NULL, NULL, NULL);
```

## src/cheri_funcs.h
```c
/*
 * Copyright (c) 2026 University of Birmingham, support for CHERI
 *
 * SPDX-License-Identifier: Apache-2.0
 */

#include <zephyr/tc_util.h>
#include <stdbool.h>
#include <zephyr/kernel.h>
#include <zephyr/ztest.h>

/* CHERI helper functions for printing and checks for twister tests */

static inline void print_cheri(const char *label, void *cap)
{
#ifdef __CHERI_PURE_CAPABILITY__
	uintptr_t cap_addr = __builtin_cheri_address_get(cap);
	uintptr_t cap_base = __builtin_cheri_base_get(cap);
	size_t cap_len  = __builtin_cheri_length_get(cap);
	size_t tag = __builtin_cheri_tag_get(cap);

	TC_PRINT("%s", label);
	TC_PRINT("CHERI addr:   0x%lx\n", (unsigned long)cap_addr);
	TC_PRINT("CHERI base:   0x%lx\n", (unsigned long)cap_base);
	TC_PRINT("CHERI top:   0x%lx\n", (unsigned long)cap_base+cap_len);
	TC_PRINT("CHERI length: %zu\n", cap_len);
	TC_PRINT("CHERI tag: %zu\n", tag);
#endif /* __CHERI_PURE_CAPABILITY__ */
}

/* mempool assertions */

static void assert_cheri_mempool(const char *label, void *cap, size_t req_len)
{
#ifdef __CHERI_PURE_CAPABILITY__
	uintptr_t cap_addr = __builtin_cheri_address_get(cap);
	uintptr_t cap_base = __builtin_cheri_base_get(cap);
	size_t cap_len  = __builtin_cheri_length_get(cap);
	size_t cap_tag  = __builtin_cheri_tag_get(cap);
	/* round up to ptr/cap size */
	size_t req_len_round_up = WB_UP(req_len);
	/* round up to CHERI requirements, include the header */
	size_t req_len_round = __builtin_cheri_round_representable_length
		(req_len_round_up + sizeof(void *));

	/* For the mempool api the usable data is preceded by a header
	 * which is a pointer to a structure k_heap
	 */
	zassert_equal(cap_addr, cap_base + sizeof(void *),
		"%s bounds base or addr not as expected", label);
	zassert_equal(cap_len, req_len_round,
		"%s not bounded %zu to req. length %zu",
			label, cap_len, req_len_round);
	zassert_not_equal(cap_tag, 0, "%s cheri tag failed", label);
#endif /* __CHERI_PURE_CAPABILITY__ */
}

static void assert_cheri_mempool_align(const char *label, void *cap, size_t req_len, size_t align)
{
#ifdef __CHERI_PURE_CAPABILITY__
	uintptr_t cap_addr = __builtin_cheri_address_get(cap);
	uintptr_t cap_base = __builtin_cheri_base_get(cap);
	size_t cap_len  = __builtin_cheri_length_get(cap);
	size_t cap_tag  = __builtin_cheri_tag_get(cap);
	size_t req_len_round = WB_UP(req_len);

	req_len_round = __builtin_cheri_round_representable_length(req_len_round + sizeof(void *));

	/* take into account alignment requests */
	size_t ptr_align = sizeof(void *);
	size_t effective_align = MAX(align, ptr_align);

	/* For the mempool api the usable data is preceded by a header
	 * which is a pointer to a structure k_heap
	 */

	/* cap_addr must be aligned to the effective alignment */
	zassert_equal(cap_addr & (effective_align - 1), 0,
		"%s cap addr not aligned to %zu",
		label, effective_align);

	/* header must be immediately before cap_addr */
	zassert_equal((cap_addr - sizeof(void *)) & (ptr_align - 1), 0,
		"%s header not pointer-aligned",
		label);

	/* cap_addr must be at least header-size past the base */
	zassert_true(cap_addr >= cap_base + sizeof(void *),
		"%s cap addr before header space",
		label);

	zassert_not_equal(cap_tag, 0, "%s cheri tag failed", label);
#endif /* __CHERI_PURE_CAPABILITY__ */
}

static void assert_cheri_invalid_tag(const char *label, void *cap)
{
#ifdef __CHERI_PURE_CAPABILITY__
	size_t cap_tag  = __builtin_cheri_tag_get(cap);

	zassert_equal(cap_tag, 0, "%s cheri tag unexpectedly succeeded", label);
#endif /* __CHERI_PURE_CAPABILITY__ */
}

static void assert_cheri_valid_tag(const char *label, void *cap)
{
#ifdef __CHERI_PURE_CAPABILITY__
	size_t cap_tag  = __builtin_cheri_tag_get(cap);

	zassert_equal(cap_tag, 1, "%s cheri invalid tag", label);
#endif /* __CHERI_PURE_CAPABILITY__ */
}

static void assert_cheri_no_overlap(const char *label, void *cap1, void *cap2)
{
#ifdef __CHERI_PURE_CAPABILITY__
	uintptr_t cap_base1 = __builtin_cheri_base_get(cap1);
	size_t cap_top1  = cap_base1 + __builtin_cheri_length_get(cap1);
	uintptr_t cap_base2 = __builtin_cheri_base_get(cap2);
	size_t cap_top2  = cap_base2 + __builtin_cheri_length_get(cap2);

	bool no_overlap = (cap_top2 <= cap_base1) ||
				(cap_base2 >= cap_top1);
	zassert_true(no_overlap, "%s bounds overlap detected", label);

#endif /* __CHERI_PURE_CAPABILITY__ */
}

static void assert_cheri_overlap(const char *label, void *cap1, void *cap2)
{
#ifdef __CHERI_PURE_CAPABILITY__
	uintptr_t cap_base1 = __builtin_cheri_base_get(cap1);
	size_t cap_top1  = cap_base1 + __builtin_cheri_length_get(cap1);
	uintptr_t cap_base2 = __builtin_cheri_base_get(cap2);
	size_t cap_top2  = cap_base2 + __builtin_cheri_length_get(cap2);

	bool no_overlap = (cap_top2 <= cap_base1) ||
				(cap_base2 >= cap_top1);
	zassert_false(no_overlap, "%s bounds overlap not detected", label);

#endif /* __CHERI_PURE_CAPABILITY__ */
}
static void assert_cheri_ptr_aligned(const char *label, void *cap)
{
#ifdef __CHERI_PURE_CAPABILITY__
	uintptr_t cap_addr = __builtin_cheri_address_get(cap);
	uintptr_t cap_base = __builtin_cheri_base_get(cap);
	size_t align = sizeof(void *);

	bool addr_aligned = ((cap_addr & (align - 1)) == 0);
	bool base_aligned = ((cap_base & (align - 1)) == 0);

	zassert_true(addr_aligned,
		"%s capability address is misaligned (addr=%#lx, align=%zu)",
		label, cap_addr, align);

	zassert_true(base_aligned,
		"%s capability base is misaligned (base=%#lx, align=%zu)",
		label, cap_base, align);
#endif /* __CHERI_PURE_CAPABILITY__ */
}

static void assert_cheri_zero_write(const char *label, void *cap)
{
#ifdef __CHERI_PURE_CAPABILITY__
	/* check memory allocation is zeroed.
	 * check we can write to the contents
	 */

	/* cast to a byte pointer */
	uint8_t *p = cap;
	/* get the full length from base */
	size_t cheri_len = __builtin_cheri_length_get(cap);
	/* subtract the header pointer */
	cheri_len = cheri_len - sizeof(void *);
	/* check zeroed and write */
	for (int i = 0; i < cheri_len; i++) {
		zassert_equal(p[i], 0);
		p[i] = 1;
	}
#endif /* __CHERI_PURE_CAPABILITY__ */
}

/* multi-heap assertions */

static void assert_cheri_singleheap(const char *label, void *cap, size_t req_len)
{
#ifdef __CHERI_PURE_CAPABILITY__
	uintptr_t cap_addr = __builtin_cheri_address_get(cap);
	uintptr_t cap_base = __builtin_cheri_base_get(cap);
	size_t cap_len  = __builtin_cheri_length_get(cap);
	size_t cap_tag  = __builtin_cheri_tag_get(cap);
	size_t req_len_round_up = WB_UP(req_len);
	size_t req_len_round = __builtin_cheri_round_representable_length
		(req_len_round_up);

	zassert_equal(cap_addr, cap_base,
		"%s bounds base and addr not aligned", label);
	zassert_equal(cap_len, req_len_round,
		"%s not bounded %zu to req. length %zu",
			label, cap_len, req_len_round);
	zassert_not_equal(cap_tag, 0, "%s cheri tag failed", label);
#endif /* __CHERI_PURE_CAPABILITY__ */
}


static void assert_cheri_within_bounds(const char *label,
					void *container,
					void *inner)
{
#ifdef __CHERI_PURE_CAPABILITY__
	uintptr_t cont_base = __builtin_cheri_base_get(container);
	size_t cont_len     = __builtin_cheri_length_get(container);
	uintptr_t cont_top  = cont_base + cont_len;

	uintptr_t inner_base = __builtin_cheri_base_get(inner);
	size_t inner_len     = __builtin_cheri_length_get(inner);
	uintptr_t inner_top  = inner_base + inner_len;

	bool within =
		(inner_base >= cont_base) &&
		(inner_top  <= cont_top);

	zassert_true(within,
		"%s bounds not fully contained:\n"
		"container=[%p..%p), inner=[%p..%p)",
		label,
		(void *)cont_base, (void *)cont_top,
		(void *)inner_base, (void *)inner_top);
#endif /* __CHERI_PURE_CAPABILITY__ */
}
```

## src/test_mempool.c
```c
/*
 * Copyright (c) 2026 University of Birmingham, added to support CHERI tests
 *
 * SPDX-License-Identifier: Apache-2.0
 *
 * These tests test the CHERI modified kernel/mempool.c heap functions
 * They test CHERI-specific aspects not covered under lib/heap/multiheap
 */

#include <zephyr/ztest.h>
#include <kernel_internal.h>
#include <zephyr/irq_offload.h>
#include <zephyr/sys/multi_heap.h>
#include "test_mheap.h"

#include "cheri_funcs.h"

#define CHERI_TEST_STACK_SIZE \
	(1024 + CONFIG_TEST_EXTRA_STACK_SIZE + \
	(BLK_NUM_MAX * sizeof(void *) * 2))

K_THREAD_STACK_DEFINE(test_tstack, CHERI_TEST_STACK_SIZE);
static struct k_thread test_tdata;

static const size_t blk_sizes[] = {
	BLK_SIZE_1,
	BLK_SIZE_2,
	BLK_SIZE_3,
	BLK_SIZE_4
};

static const size_t alignment[] = {
	ALIGN_1,
	ALIGN_2,
	ALIGN_3,
	ALIGN_4
};

static void malloc_handler(void *p1, void *p2, void *p3)
{
	void *block[2 * BLK_NUM_MAX];
	int num_allocs;

	size_t blk_size = *(size_t *)p1;

	TC_PRINT("--------- Allocate memory until empty with new block size ---------\n");

	for (num_allocs = 0; num_allocs < ARRAY_SIZE(block); num_allocs++) {
		block[num_allocs] = k_malloc(blk_size);
		if (block[num_allocs] == NULL) {
			break;
		}
		/* check bounds of allocation*/
		/* CHERI bounds will include block size + header + CHERI rounding */
		assert_cheri_mempool("block[num_allocs]\n", block[num_allocs], blk_size);
		/* check base and addr are both aligned to a cap ptr size */
		assert_cheri_ptr_aligned("block[num_allocs]\n", block[num_allocs]);
	}

	TC_PRINT("blk_size: %zu, number of allocations: %zu\n", blk_size, (size_t)num_allocs);
	TC_PRINT("First allocation:\n");
	TC_PRINT("block[0] %p\n", block[0]);
	print_cheri("block[0]\n", block[0]);
	TC_PRINT("Second allocation:\n");
	TC_PRINT("block[1] %p\n", block[1]);
	print_cheri("block[1]\n", block[1]);

	/* check no overlapping bounds between first and second allocation
	 * skip test if we already run out of memory
	 */
	if (block[1] == NULL) {
		TC_PRINT("block[1] NULL, skipping overlap check\n");
	} else {
		assert_cheri_no_overlap("block[0], block[1]\n", block[0], block[1]);
	}

	for (int i = 0; i < num_allocs; i++) {
		k_free(block[i]);
	}
}

static void calloc_handler(void *p1, void *p2, void *p3)
{
	void *block[2 * BLK_NUM_MAX];
	int num_allocs;

	size_t blk_size = *(size_t *)p1;
	size_t numElements = 3;

	TC_PRINT("--------- Allocate memory until empty with new block size ---------\n");

	for (num_allocs = 0; num_allocs < ARRAY_SIZE(block); num_allocs++) {
		block[num_allocs] = k_calloc(numElements, blk_size);
		if (block[num_allocs] == NULL) {
			break;
		}
		/* check bounds of allocation*/
		/* CHERI bounds will include block size + header + CHERI rounding */
		assert_cheri_mempool("block[num_allocs]\n", block[num_allocs],
			 numElements * blk_size);
		/* check base and addr are both aligned to a cap ptr size */
		assert_cheri_ptr_aligned("block[num_allocs]\n", block[num_allocs]);
		/* check memory is zero and can write to the contents */
		assert_cheri_zero_write("block[num_allocs]\n", block[num_allocs]);
	}

	TC_PRINT("blk_size: %zu, numElements: %zu, number of allocations: %zu\n",
		blk_size, numElements, (size_t)num_allocs);
	TC_PRINT("First allocation:\n");
	TC_PRINT("block[0] %p\n", block[0]);
	print_cheri("block[0]\n", block[0]);
	TC_PRINT("Second allocation:\n");
	TC_PRINT("block[1] %p\n", block[1]);
	print_cheri("block[1]\n", block[1]);

	/* check no overlapping bounds between first and second allocation
	 * skip test if we already run out of memory
	 */
	if (block[1] == NULL) {
		TC_PRINT("block[1] NULL, skipping overlap check\n");
	} else {
		assert_cheri_no_overlap("block[0], block[1]\n", block[0], block[1]);
	}

	for (int i = 0; i < num_allocs; i++) {
		k_free(block[i]);
	}
}

static void aligned_alloc_handler(void *p1, void *p2, void *p3)
{
	void *block[2 * BLK_NUM_MAX];
	int num_allocs;

	size_t alignment = *(size_t *)p1;

	TC_PRINT("--------- Allocate memory until empty with new alignment ---------\n");
	TC_PRINT("block size: %zu, new alignment: %zu,",
				(size_t)BLK_SIZE_3, (size_t)alignment);
#ifdef __CHERI_PURE_CAPABILITY__
	TC_PRINT(" expected user alignment (at least ptr align): %zu",
				(size_t)MAX(alignment, sizeof(void *)));
#endif
	TC_PRINT("\n");

	for (num_allocs = 0; num_allocs < ARRAY_SIZE(block); num_allocs++) {
		block[num_allocs] = k_aligned_alloc(alignment, BLK_SIZE_3);
		if (block[num_allocs] == NULL) {
			break;
		}
		/* check bounds and alignment of first allocation*/
		/* CHERI bounds will include block size + header + alignment pad + cheri rounding */
		assert_cheri_mempool_align("block[num_allocs]\n",
			block[num_allocs], BLK_SIZE_3, alignment);
		/* check base and addr are both aligned to at least cap ptr size */
		assert_cheri_ptr_aligned("block[num_allocs]\n", block[num_allocs]);
	}

	TC_PRINT("number of allocations: %zu\n", (size_t)num_allocs);
	TC_PRINT("First allocation:\n");
	TC_PRINT("block[0] %p\n", block[0]);
	print_cheri("block[0]\n", block[0]);
	TC_PRINT("Second allocation:\n");
	TC_PRINT("block[1] %p\n", block[1]);
	print_cheri("block[1]\n", block[1]);

	/* check no overlapping bounds between first and second allocation
	 * skip test if we already run out of memory
	 */
	if (block[1] == NULL) {
		TC_PRINT("block[1] NULL, skipping overlap check\n");
	} else {
		assert_cheri_no_overlap("block[0], block[1]\n", block[0], block[1]);
	}

	for (int i = 0; i < num_allocs; i++) {
		k_free(block[i]);
	}
}

static void thread_alloc_in_thread_handler(void *p1, void *p2, void *p3)
{
	void *block[2 * BLK_NUM_MAX];
	int num_allocs;
	size_t blk_size = *(size_t *)p1;

	TC_PRINT("--------- Allocate memory until empty with new block size ---------\n");

	for (num_allocs = 0; num_allocs < ARRAY_SIZE(block); num_allocs++) {
		block[num_allocs] = z_thread_malloc(blk_size);
		if (block[num_allocs] == NULL) {
			break;
		}
		/* check bounds of allocation*/
		assert_cheri_mempool("block[num_allocs]\n",
			block[num_allocs], blk_size);
		/* check base and addr are both aligned to a cap ptr size */
		assert_cheri_ptr_aligned("block[num_allocs]\n", block[num_allocs]);
	}

	TC_PRINT("blk_size: %zu, number of allocations: %zu\n", blk_size, (size_t)num_allocs);
	TC_PRINT("First allocation:\n");
	TC_PRINT("block[0] %p\n", block[0]);
	print_cheri("block[0]\n", block[0]);
	TC_PRINT("Second allocation:\n");
	TC_PRINT("block[1] %p\n", block[1]);
	print_cheri("block[1]\n", block[1]);

	/* check no overlapping bounds between first and second allocation
	 * skip test if we already run out of memory
	 */
	if (block[1] == NULL) {
		TC_PRINT("block[1] NULL, skipping overlap check\n");
	} else {
		assert_cheri_no_overlap("block[0], block[1]\n", block[0], block[1]);
	}

	for (int i = 0; i < num_allocs; i++) {
		k_free(block[i]);
	}
}

static void thread_aligned_alloc_in_thread_handler(void *p1, void *p2, void *p3)
{
	void *block[2 * BLK_NUM_MAX];
	int num_allocs;

	size_t alignment = *(size_t *)p1;

	TC_PRINT("--------- Allocate memory until empty with new alignment ---------\n");
	TC_PRINT("block size: %zu, new alignment: %zu,", (size_t)BLK_SIZE_3, (size_t)alignment);
#ifdef __CHERI_PURE_CAPABILITY__
	TC_PRINT(" expected user alignment (at least ptr align): %zu",
				(size_t)MAX(alignment, sizeof(void *)));
#endif
	TC_PRINT("\n");

	for (num_allocs = 0; num_allocs < ARRAY_SIZE(block); num_allocs++) {
		block[num_allocs] = z_thread_aligned_alloc(alignment, BLK_SIZE_3);
		if (block[num_allocs] == NULL) {
			break;
		}
		/* check bounds of first allocation */
		/* CHERI bounds will include block size + header + alignment pad + cheri rounding */
		assert_cheri_mempool_align("block[num_allocs]\n",
			block[num_allocs], BLK_SIZE_3, alignment);
		/* check base and addr are both aligned to a cap ptr size */
		assert_cheri_ptr_aligned("block[num_allocs]\n", block[num_allocs]);
	}

	TC_PRINT("blk_size: %zu, number of allocations: %zu\n",
		(size_t)BLK_SIZE_3, (size_t)num_allocs);
	TC_PRINT("First allocation:\n");
	TC_PRINT("block[0] %p\n", block[0]);
	print_cheri("block[0]\n", block[0]);
	TC_PRINT("Second allocation:\n");
	TC_PRINT("block[1] %p\n", block[1]);
	print_cheri("block[1]\n", block[1]);

	/* check no overlapping bounds between first and second allocation
	 * skip test if we already run out of memory
	 */
	if (block[1] == NULL) {
		TC_PRINT("block[1] NULL, skipping overlap check\n");
	} else {
		assert_cheri_no_overlap("block[0], block[1]\n", block[0], block[1]);
	}

	for (int i = 0; i < num_allocs; i++) {
		k_free(block[i]);
	}
}

static void realloc_handler(void *p1, void *p2, void *p3)
{
	void *block1, *block2;
	size_t num_allocs, i;
	size_t blk_size = *(size_t *)p1;

	/* First allocation */

	TC_PRINT("--------- Allocate memory with new block size ---------\n");
	TC_PRINT("blk_size: %zu, blk_size + header: %zu\n",
		(size_t)blk_size, (size_t)blk_size + sizeof(void *));

	block1 = k_realloc(NULL, blk_size);
	block2 = block1; /* save first allocation */

	TC_PRINT("block1 %p\n", block1);
	print_cheri("block1\n", block1);
	/* check bounds of allocation*/
	assert_cheri_mempool("block1", block1, blk_size);
	/* check valid */
	zassert_not_null(block1);

	/* Keep making the allocated buffer bigger until the heap is depleted
	 * For bounds expansion CHERI uses alloc + copy so the new and old
	 * should not overlap unless they fall into the same CHERI rounded bounds
	 */
	TC_PRINT("Expanding bounds and doing memory depletion....\n");

	for (num_allocs = 2; num_allocs < (2 * BLK_NUM_MAX); num_allocs++) {

		void *last_block1 = block1;

		TC_PRINT("%zu * blk_size: %zu\n", (size_t)num_allocs, num_allocs * blk_size);

		block1 = k_realloc(block1, num_allocs * blk_size);

		/* For CHERI we can't expand the bounds of an allocated pointer
		 * without going back to the original heap pointer first
		 * and then re-allocating. CHERI uses the default
		 * option to allocate new and then copy the data.
		 * We need to ensure the heap is big enough to do the copy
		 * to allow at least 1 re-allocation.
		 */

		if (block1 == NULL) {
			block1 = last_block1;
			break;
		}

		/* check bounds of allocation*/
		assert_cheri_mempool("block1\n", block1, num_allocs * blk_size);
		/* check base and addr are both aligned to a cap ptr size */
		assert_cheri_ptr_aligned("block1\n", block1);
	}
	TC_PRINT("number of re-allocations: %zu\n", (size_t)num_allocs);
	TC_PRINT("Last allocation:\n");
	TC_PRINT("block1 %p\n", block1);
	print_cheri("block1\n", block1);
	/* check no overlapping bounds between first and last allocation
	 * Note: some reallocations in loop may overlap if still within bounds
	 * due to CHERI rounding
	 */
	assert_cheri_no_overlap("first, last\n", block2, block1);

	/* Now Keep making the allocated buffer smaller, all allocations
	 * should overlap
	 */
	TC_PRINT("Reducing bounds and checking for overlap....\n");

	for (i = num_allocs-1; i > 0; i--) {
		void *last_block1 = block1;

		TC_PRINT("%zu * blk_size: %zu\n", (size_t)i, i * blk_size);

		block1 = k_realloc(block1, i * blk_size);

		/* check bounds overlap in all cases */
		assert_cheri_overlap("block1, last_block1\n", block1, last_block1);
		/* check bounds of allocation*/
		assert_cheri_mempool("block1\n", block1, i * blk_size);
		/* check base and addr are both aligned to a cap ptr size */
		assert_cheri_ptr_aligned("block1\n", block1);
		zassert_not_null(block1);
	}

	TC_PRINT("Last allocation:\n");
	TC_PRINT("block1 %p\n", block1);
	print_cheri("block1\n", block1);

	/* Deallocate and null pointer */
	block1 = k_realloc(block1, 0);
	/* Return NULL after freed */
	zassert_is_null(block1);
}

/*test cases*/

/**
 * @brief Test to demonstrate CHERI-modified k_malloc() and k_free()
 *
 * @ingroup cheri_k_heap_api_tests
 *
 * @details The test allocates from heap memory pool using k_malloc().
 * It repeats for different block sizes to check CHERI rounding
 * and alignment. It uses k_free() to free all the allocated memory.
 *
 * @see k_malloc()
 */
ZTEST(cheri_mheap_api, test_a_k_malloc)
{
	if (!IS_ENABLED(CONFIG_MULTITHREADING)) {
		return;
	}

	TC_PRINT("CONFIG_HEAP_MEM_POOL_SIZE: %i\n", CONFIG_HEAP_MEM_POOL_SIZE);

	for (int i = 0; i < ARRAY_SIZE(blk_sizes); i++) {
		k_tid_t tid = k_thread_create(&test_tdata, test_tstack,
				 CHERI_TEST_STACK_SIZE,
				 malloc_handler,
				 (void *)&blk_sizes[i],  /* p1 = pointer to block size */
				  NULL, NULL,
				 K_PRIO_PREEMPT(1), 0, K_NO_WAIT);

		k_thread_join(tid, K_FOREVER);
	}
}

/**
 * @brief Test to demonstrate CHERI-modified k_calloc().
 *
 * @ingroup cheri_k_heap_api_tests
 *
 * @details The test allocates from heap memory pool using k_calloc().
 * It repeats for different block sizes to check CHERI rounding
 * and alignment. It checks the memory is zeroed and can be
 * written to. It uses k_free() to free all the allocated memory.
 *
 * @see k_calloc()
 */
ZTEST(cheri_mheap_api, test_b_k_calloc)
{
	if (!IS_ENABLED(CONFIG_MULTITHREADING)) {
		return;
	}

	TC_PRINT("CONFIG_HEAP_MEM_POOL_SIZE: %i\n", CONFIG_HEAP_MEM_POOL_SIZE);

	for (int i = 0; i < ARRAY_SIZE(blk_sizes); i++) {
		k_tid_t tid = k_thread_create(&test_tdata, test_tstack,
				 CHERI_TEST_STACK_SIZE,
				 calloc_handler,
				 (void *)&blk_sizes[i],  /* p1 = pointer to block size */
				  NULL, NULL,
				 K_PRIO_PREEMPT(1), 0, K_NO_WAIT);

		k_thread_join(tid, K_FOREVER);
	}
}

/**
 * @brief Test to demonstrate CHERI-modified k_aligned_alloc().
 *
 * @ingroup cheri_k_heap_api_tests
 *
 * @details The test allocates from heap memory pool using k_aligned_alloc().
 * It repeats for different alignment sizes to check CHERI rounding
 * and alignment. It uses k_free() to free all the allocated memory.
 *
 * @see k_aligned_alloc()
 */
ZTEST(cheri_mheap_api, test_c_k_aligned_alloc)
{
	if (!IS_ENABLED(CONFIG_MULTITHREADING)) {
		return;
	}

	TC_PRINT("CONFIG_HEAP_MEM_POOL_SIZE: %i\n", CONFIG_HEAP_MEM_POOL_SIZE);

	for (int i = 0; i < ARRAY_SIZE(alignment); i++) {
		k_tid_t tid = k_thread_create(&test_tdata, test_tstack,
				 CHERI_TEST_STACK_SIZE,
				 aligned_alloc_handler,
				 (void *)&alignment[i],  /* p1 = pointer to alignment */
				  NULL, NULL,
				 K_PRIO_PREEMPT(1), 0, K_NO_WAIT);

		k_thread_join(tid, K_FOREVER);
	}
}

/**
 * @brief Test to demonstrate CHERI-modified z_thread_malloc().
 *
 * @details The test allocates from heap memory pool using z_thread_malloc().
 * It repeats for different block sizes to check CHERI rounding
 * and alignment. It uses k_free() to free all the allocated memory.
 *
 * @ingroup cheri_k_heap_api_tests
 *
 * @see z_thread_malloc()
 */
ZTEST(cheri_mheap_api, test_d_z_thread_malloc)
{
	if (!IS_ENABLED(CONFIG_MULTITHREADING)) {
		return;
	}

	for (int i = 0; i < ARRAY_SIZE(blk_sizes); i++) {

		k_tid_t tid = k_thread_create(&test_tdata, test_tstack,
				 CHERI_TEST_STACK_SIZE,
				 thread_alloc_in_thread_handler,
				 (void *)&blk_sizes[i],  /* p1 = pointer to block size */
				 NULL, NULL,
				 K_PRIO_PREEMPT(1), 0, K_NO_WAIT);

		k_thread_join(tid, K_FOREVER);
	}
}

/**
 * @brief Test to demonstrate CHERI-modified z_thread_aligned_alloc().
 *
 * @details The test allocates from heap memory pool using
 * z_thread_aligned_alloc().
 * It repeats for different alignment sizes to check CHERI rounding
 * and alignment. It uses k_free() to free all the allocated memory.
 *
 * @ingroup cheri_k_heap_api_tests
 *
 * @see z_thread_aligned_alloc()
 */
ZTEST(cheri_mheap_api, test_e_z_thread_aligned_alloc)
{
	if (!IS_ENABLED(CONFIG_MULTITHREADING)) {
		return;
	}

	for (int i = 0; i < ARRAY_SIZE(alignment); i++) {
		k_tid_t tid = k_thread_create(&test_tdata, test_tstack,
				 CHERI_TEST_STACK_SIZE,
				 thread_aligned_alloc_in_thread_handler,
				 (void *)&alignment[i],  /* p1 = pointer to alignment */
				 NULL, NULL,
				 K_PRIO_PREEMPT(1), 0, K_NO_WAIT);

		k_thread_join(tid, K_FOREVER);
	}
}

/**
 * @brief Test to demonstrate CHERI-modified k_realloc().
 *
 * @details The test allocates from heap memory pool using
 * k_realloc().
 * It repeats for different block sizes to check CHERI rounding
 * and alignment. It uses k_free() to free all the allocated memory.
 *
 * @ingroup cheri_k_heap_api_tests
 *
 * @see k_realloc()
 */
ZTEST(cheri_mheap_api, test_f_k_realloc)
{
	if (!IS_ENABLED(CONFIG_MULTITHREADING)) {
		return;
	}

	for (int i = 0; i < ARRAY_SIZE(blk_sizes); i++) {

		k_tid_t tid = k_thread_create(&test_tdata, test_tstack,
				 CHERI_TEST_STACK_SIZE,
				 realloc_handler,
				 (void *)&blk_sizes[i],  /* p1 = pointer to block size */
				 NULL, NULL,
				 K_PRIO_PREEMPT(1), 0, K_NO_WAIT);

		k_thread_join(tid, K_FOREVER);
	}
}
```

## src/test_mheap.h
```c
/*
 * Copyright (c) 2026 University of Birmingham, added to support CHERI tests
 *
 * SPDX-License-Identifier: Apache-2.0
 */

/* set sizes to ensure cheri rounding and
 * alignment calculations are exercised
 */
#define BLK_SIZE_1 7
#define BLK_SIZE_2 68
#define BLK_SIZE_3 133
#define BLK_SIZE_4 260
#define ALIGN_1 1
#define ALIGN_2 8
#define ALIGN_3 16
#define ALIGN_4 32

#define BLK_SIZE_MIN 64
#define BLK_NUM_MAX (K_HEAP_MEM_POOL_SIZE / BLK_SIZE_MIN)
#define BLK_NUM_MIN (K_HEAP_MEM_POOL_SIZE / (BLK_SIZE_MIN << 2))
```

## src/test_multiheap.c
```c
/*
 * Copyright (c) 2026 University of Birmingham, added to support CHERI tests
 *
 * These tests test the CHERI modified heap and kernel/multi_heap.c heap functions
 * They test CHERI-specific aspects not covered under lib/heap/multiheap
 *
 * SPDX-License-Identifier: Apache-2.0
 */

#include <zephyr/ztest.h>
#include <kernel_internal.h>
#include <zephyr/irq_offload.h>
#include <zephyr/sys/multi_heap.h>

#include "test_mheap.h"
#include "cheri_funcs.h"

/* multi heaps */
/* number of heaps */
#define N_MULTI_HEAPS 4
/* size of each heap: purposefully set an awkward size
 * use CHERI macros to round up. This ensures that when
 * the bounds split into individual heaps it can be done
 * cleanly. Alternatively stick to powers-of-2
 */
#ifdef __CHERI_PURE_CAPABILITY__
#define AWKWARD_SIZE 333
#define MHEAP_BYTES CHERI_ROUND_UP_TO_REP_LEN(WB_UP(AWKWARD_SIZE), 1)
#else
#define MHEAP_BYTES 256
#endif

static const size_t alignment[] = {
	ALIGN_1,
	ALIGN_2,
	ALIGN_3,
	ALIGN_4
};

/* multiheap structure */
static struct sys_multi_heap multi_heap;
/* backing buffer */
/* we align the backing buffer memory to 'at least' pointer size because
 * a single heap is internally CHERI aligned to at least a pointer size.
 * Without this, if the alignment of heap_mem comes out at 4 bytes say
 * you end up with a single heap size less than you asked for.
 */
__aligned(sizeof(void *)) static char heap_mem[N_MULTI_HEAPS][MHEAP_BYTES];
/* array of ptrs to each heap structure */
static struct sys_heap mheaps[N_MULTI_HEAPS];


void *multi_heap_choice(struct sys_multi_heap *mheap, void *cfg,
			size_t align, size_t size)
{
	struct sys_heap *h = cfg;

	return sys_heap_aligned_alloc(h, align, size);
}

/*test cases*/

/**
 * @brief Test to demonstrate CHERI-modified heap with sys_multi_heap_init()
 *
 * @ingroup cheri_k_heap_api_tests
 *
 * @details The test initialises multi-heaps and checks
 * CHERI rounding and alignment.
 *
 * @see sys_multi_heap_init()
 */
ZTEST(cheri_mheap_api, test_g_sys_multi_heap_init)
{
	/* backing buffer heap_mem */
	TC_PRINT("Number heaps: %zu, size each heap: %zu, backing buffer size: %zu\n",
		(size_t)N_MULTI_HEAPS, (size_t)MHEAP_BYTES, (size_t)MHEAP_BYTES * N_MULTI_HEAPS);
	TC_PRINT("heap_mem: %p\n", heap_mem);
	print_cheri("", heap_mem);
	/* check valid cap */
	assert_cheri_valid_tag("heap_mem - not valid\n", heap_mem);
	/* check correctly cheri rounded, aligned and bounded */
	assert_cheri_singleheap("", heap_mem, MHEAP_BYTES * N_MULTI_HEAPS);

	/* individual heaps */

	/* set allocation function to use for multi_heap */
	sys_multi_heap_init(&multi_heap, multi_heap_choice);

	/* initialise each heap structure in mheaps from backing buffer heap_mem */
	for (int i = 0; i < N_MULTI_HEAPS; i++) {
		/* Reduce CHERI bounds from heap array &heap_mem[i][0]
		 * to a single heap for mheaps[i].heap
		 */
		sys_heap_init(&mheaps[i], &heap_mem[i][0], MHEAP_BYTES);
		/* register and sort heaps */
		sys_multi_heap_add_heap(&multi_heap, &mheaps[i], NULL);
	}

	/* print bounds of individual heaps */

	/* single heap memory from structure
	 * mheaps[i].heap is a pointer to z_heap struct,
	 * which sits at the start of a single heap memory
	 * It has CHERI bounds covering a single heap.
	 * The CHERI bounds for heap_mem[i] are inherited from
	 * the whole backing buffer.
	 */
	for (int i = 0; i < N_MULTI_HEAPS; i++) {
		TC_PRINT("--------- Heap %zu ---------\n", (size_t)i);
		TC_PRINT("mheaps[%zu].heap: %p\n", (size_t)i, mheaps[i].heap);
		print_cheri("", mheaps[i].heap);
		/* check valid cap */
		assert_cheri_valid_tag("mheaps[i].heap - not valid\n", mheaps[i].heap);
		/* check correctly cheri rounded, aligned and bounded */
		assert_cheri_singleheap("", mheaps[i].heap, MHEAP_BYTES);
	}
}

/**
 * @brief Test to demonstrate CHERI-modified heap with sys_multi_heap_alloc()
 *
 * @ingroup cheri_k_heap_api_tests
 *
 * @details The test allocates blocks of memory from  multi-heaps
 * and checks CHERI rounding and alignment. Memory is freed using
 * sys_multi_heap_free().
 *
 * @see sys_multi_heap_alloc()
 */
ZTEST(cheri_mheap_api, test_h_sys_multi_heap_alloc)
{
	char *blocks[N_MULTI_HEAPS];

	TC_PRINT("--------- Allocate from each heap memory ---------\n");
	TC_PRINT("block_size: %zu\n", (size_t)MHEAP_BYTES / 2);

	/* allocate blocks */
	for (int i = 0; i < N_MULTI_HEAPS; i++) {

		blocks[i] = sys_multi_heap_alloc(&multi_heap, &mheaps[i],
						 MHEAP_BYTES / 2);

		TC_PRINT("--------- Heap %zu ---------\n", (size_t)i);
		TC_PRINT("blocks[%zu]: %p\n", (size_t)i, blocks[i]);
		print_cheri("", blocks[i]);

		/* check bounds of allocation*/
		assert_cheri_singleheap("", blocks[i], MHEAP_BYTES / 2);
		/* check bounds contained within correct heap */
		assert_cheri_within_bounds("", mheaps[i].heap, blocks[i]);
		/* check base and addr are both aligned to a cap ptr size */
		assert_cheri_ptr_aligned("blocks[i]\n", blocks[i]);
#ifndef __CHERI_PURE_CAPABILITY__
		/* keep for non-CHERI build */
		zassert_not_null(blocks[i], "allocation failed");
		zassert_true(blocks[i] >= &heap_mem[i][0] &&
			     blocks[i] < &heap_mem[i+1][0],
			     "allocation not in correct heap");
#endif
	}

	/* Free blocks */
	for (int i = 0; i < N_MULTI_HEAPS; i++) {
		sys_multi_heap_free(&multi_heap, blocks[i]);
	}

}

/**
 * @brief Test to demonstrate CHERI-modified heap with sys_multi_heap_realloc()
 *
 * @ingroup cheri_k_heap_api_tests
 *
 * @details The test allocates and reallocates blocks of memory from
 *  multi-heaps checking shrinking and expansion, and checks CHERI
 * rounding and alignment. Memory is freed using sys_multi_heap_free().
 *
 * @see sys_multi_heap_realloc()
 */
ZTEST(cheri_mheap_api, test_i_sys_multi_heap_realloc)
{
	char *blocks[N_MULTI_HEAPS];

	for (int i = 0; i < N_MULTI_HEAPS; i++) {

		/* allocate block */

		blocks[i] = sys_multi_heap_alloc(&multi_heap, &mheaps[i],
					 MHEAP_BYTES / 4);

		TC_PRINT("--------- Heap %zu ---------\n", (size_t)i);
		TC_PRINT("blocks[%zu] - alloc some memory: %p\n", (size_t)i, blocks[i]);
		print_cheri("", blocks[i]);
		/* check valid cap */
		assert_cheri_valid_tag("blocks[i] - allocation failed\n", blocks[i]);

#ifndef __CHERI_PURE_CAPABILITY__
		/* keep for non-CHERI build */
		zassert_not_null(blocks[i], "allocation failed");
#endif

		/* in place reallocation same size */
		void *ptr = sys_multi_heap_realloc(&multi_heap, &mheaps[i],
			blocks[i], MHEAP_BYTES / 4);

		TC_PRINT("ptr - realloc same size: %p\n", ptr);
		print_cheri("", ptr);
		/* check valid cap */
		assert_cheri_valid_tag("ptr - allocation failed\n", ptr);
		/* check bounds within prev */
		assert_cheri_within_bounds("", blocks[i], ptr);
		/* check bounds of allocation*/
		assert_cheri_singleheap("", ptr, MHEAP_BYTES / 4);
		/* check base and addr are both aligned to a cap ptr size */
		assert_cheri_ptr_aligned("ptr\n", ptr);

		zassert_equal(ptr, blocks[i], "realloc moved pointer");

		/* in place reallocation smaller size */
		void *ptr2 = sys_multi_heap_realloc(&multi_heap, &mheaps[i],
			blocks[i], MHEAP_BYTES / 8);

		TC_PRINT("ptr2 realloc shrink size: %p\n", ptr2);
		print_cheri("", ptr2);
		/* check valid cap */
		assert_cheri_valid_tag("ptr2 - reallocation failed\n", ptr2);
		/* check bounds within prev */
		assert_cheri_within_bounds("", ptr, ptr2);
		/* check bounds of allocation*/
		assert_cheri_singleheap("", ptr2, MHEAP_BYTES / 8);
		/* check base and addr are both aligned to a cap ptr size */
		assert_cheri_ptr_aligned("ptr2\n", ptr2);

#ifndef __CHERI_PURE_CAPABILITY__
		/* keep for non-CHERI build */
		zassert_equal(ptr2, ptr, "realloc moved pointer");
#endif

		/* in place reallocation increase size - alloc and copy for CHERI */
		blocks[i] = sys_multi_heap_realloc(&multi_heap, &mheaps[i],
			ptr2, MHEAP_BYTES / 4);

		TC_PRINT("blocks[%zu] realloc increase size: %p\n", (size_t)i, blocks[i]);
		print_cheri("", blocks[i]);
		/* check valid cap */
		assert_cheri_valid_tag("blocks[i] - heap not big enough to re-alloc\n", blocks[i]);
		/* check bounds do not overlap */
		assert_cheri_no_overlap("", ptr2, blocks[i]);
		/* check bounds still within this heap */
		assert_cheri_within_bounds("", mheaps[i].heap, blocks[i]);
		/* check bounds of allocation*/
		assert_cheri_singleheap("", blocks[i], MHEAP_BYTES / 4);
		/* check base and addr are both aligned to a cap ptr size */
		assert_cheri_ptr_aligned("blocks[i]\n", blocks[i]);

#ifndef __CHERI_PURE_CAPABILITY__
		/* keep for non-CHERI build - realloc increase in place */
		zassert_equal(blocks[i], ptr2, "realloc moved pointer");
#endif
	}

	/* Free blocks */
	for (int i = 0; i < N_MULTI_HEAPS; i++) {
		sys_multi_heap_free(&multi_heap, blocks[i]);
	}
}

/**
 * @brief Test to demonstrate CHERI-modified heap with sys_multi_heap_aligned_alloc()
 *
 * @ingroup cheri_k_heap_api_tests
 *
 * @details The test allocates blocks of memory from  multi-heaps.
 * It repeats for different alignment sizes to check CHERI rounding
 * and alignment. Memory is freed using sys_multi_heap_free().
 *
 * @see sys_multi_heap_aligned_alloc()
 */
ZTEST(cheri_mheap_api, test_j_sys_multi_heap_aligned_alloc)
{
	char *blocks[N_MULTI_HEAPS];

	/* do for all alignments */
	for (int j = 0; j < ARRAY_SIZE(alignment); j++) {
		TC_PRINT("--------- New alignment for allocations: %zu ---------\n", alignment[j]);
		/* allocate blocks */
		for (int i = 0; i < N_MULTI_HEAPS; i++) {

			blocks[i] = sys_multi_heap_aligned_alloc(&multi_heap, &mheaps[i],
						 alignment[j], MHEAP_BYTES / 2);

			TC_PRINT("--------- Heap %zu ---------\n", (size_t)i);
			TC_PRINT("blocks[%zu]: %p\n", (size_t)i, blocks[i]);
			print_cheri("", blocks[i]);
			/* check valid cap */
			assert_cheri_valid_tag("blocks[i] - not allocated\n", blocks[i]);
			/* check bounds of allocation*/
			assert_cheri_singleheap("blocks[i]", blocks[i], MHEAP_BYTES / 2);
			/* check bounds contained within correct heap */
			assert_cheri_within_bounds("", mheaps[i].heap, blocks[i]);
			/* check base and addr are both aligned to a cap ptr size */
			assert_cheri_ptr_aligned("blocks[i]\n", blocks[i]);

#ifndef __CHERI_PURE_CAPABILITY__
			/* keep for non-CHERI build */
			zassert_not_null(blocks[i], "allocation failed");
			zassert_true(blocks[i] >= &heap_mem[i][0] &&
			     blocks[i] < &heap_mem[i+1][0],
			     "allocation not in correct heap");
#endif
		}

		/* Free blocks */
		for (int i = 0; i < N_MULTI_HEAPS; i++) {
			sys_multi_heap_free(&multi_heap, blocks[i]);
		}
	}
}

/**
 * @brief Test to demonstrate CHERI-modified heap with sys_multi_heap_aligned_realloc()
 *
 * @ingroup cheri_k_heap_api_tests
 *
 * @details The test allocates and reallocates blocks of memory from
 * multi-heaps checking shrinking and expansion. It repeats for
 * different alignment sizes to check CHERI rounding and alignment.
 * Memory is freed using sys_multi_heap_free().
 *
 * @see sys_multi_heap_aligned_realloc()
 */
ZTEST(cheri_mheap_api, test_k_sys_multi_heap_aligned_realloc)
{
	char *blocks[N_MULTI_HEAPS];

/* do for all alignments */
	for (int j = 0; j < ARRAY_SIZE(alignment); j++) {
		TC_PRINT("--------- New alignment for allocations: %zu ---------\n", alignment[j]);
		for (int i = 0; i < N_MULTI_HEAPS; i++) {
			TC_PRINT("--------- Heap %zu ---------\n", (size_t)i);

			/* allocate block */

			blocks[i] = sys_multi_heap_aligned_alloc(&multi_heap, &mheaps[i],
					 alignment[j], MHEAP_BYTES / 4);

			TC_PRINT("blocks[%zu] - alloc some memory: %p\n", (size_t)i, blocks[i]);
			print_cheri("", blocks[i]);
			/* check valid cap */
			assert_cheri_valid_tag("blocks[i] - allocation failed\n", blocks[i]);

#ifndef __CHERI_PURE_CAPABILITY__
			/* keep for non-CHERI build */
			zassert_not_null(blocks[i], "allocation failed");
#endif

			/* in place reallocation same size */
			void *ptr = sys_multi_heap_aligned_realloc(&multi_heap, &mheaps[i],
					blocks[i], alignment[j], MHEAP_BYTES / 4);


			TC_PRINT("ptr - realloc same size: %p\n", ptr);
			print_cheri("", ptr);
			/* check valid cap */
			assert_cheri_valid_tag("ptr - allocation failed\n", ptr);
			/* check bounds within prev */
			assert_cheri_within_bounds("", blocks[i], ptr);
			/* check bounds of allocation*/
			assert_cheri_singleheap("", ptr, MHEAP_BYTES / 4);
			/* check base and addr are both aligned to a cap ptr size */
			assert_cheri_ptr_aligned("ptr\n", ptr);

			zassert_equal(ptr, blocks[i], "realloc moved pointer");

			/* in place reallocation smaller size */
			void *ptr2 = sys_multi_heap_aligned_realloc(&multi_heap, &mheaps[i],
						blocks[i], alignment[j], MHEAP_BYTES / 8);

			TC_PRINT("ptr2 realloc shrink size: %p\n", ptr2);
			print_cheri("", ptr2);
			/* check valid cap */
			assert_cheri_valid_tag("ptr2 - reallocation failed\n", ptr2);
			/* check bounds within prev */
			assert_cheri_within_bounds("", ptr, ptr2);
			/* check bounds of allocation*/
			assert_cheri_singleheap("", ptr2, MHEAP_BYTES / 8);
			/* check base and addr are both aligned to a cap ptr size */
			assert_cheri_ptr_aligned("ptr2\n", ptr2);

#ifndef __CHERI_PURE_CAPABILITY__
			/* keep for non-CHERI build */
			zassert_equal(ptr2, ptr, "realloc moved pointer");
#endif

			/* in place reallocation increase size - alloc and copy for CHERI */
			blocks[i] = sys_multi_heap_aligned_realloc(&multi_heap, &mheaps[i],
					ptr2, alignment[j], MHEAP_BYTES / 4);

			TC_PRINT("blocks[%zu] realloc increase size: %p\n", (size_t)i, blocks[i]);
			print_cheri("", blocks[i]);
			/* check valid cap */
			assert_cheri_valid_tag("blocks[i] - heap not big enough to re-alloc\n",
								blocks[i]);
			/* check bounds do not overlap */
			assert_cheri_no_overlap("", ptr2, blocks[i]);
			/* check bounds still within this heap */
			assert_cheri_within_bounds("", mheaps[i].heap, blocks[i]);
			/* check bounds of allocation*/
			assert_cheri_singleheap("", blocks[i], MHEAP_BYTES / 4);
			/* check base and addr are both aligned to a cap ptr size */
			assert_cheri_ptr_aligned("blocks[i]\n", blocks[i]);

#ifndef __CHERI_PURE_CAPABILITY__
			/* keep for non-CHERI build realloc increase in place */
			zassert_equal(blocks[i], ptr2, "realloc moved pointer");
#endif
		}

		/* Free blocks */
		for (int i = 0; i < N_MULTI_HEAPS; i++) {
			sys_multi_heap_free(&multi_heap, blocks[i]);
		}
	}
}
```
