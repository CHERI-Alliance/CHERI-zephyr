## CMakeLists.txt
```
# SPDX-License-Identifier: Apache-2.0

cmake_minimum_required(VERSION 3.20.0)
find_package(Zephyr REQUIRED HINTS $ENV{ZEPHYR_BASE})
project(dynamic_stack)

FILE(GLOB app_sources src/*.c)
target_sources(app PRIVATE ${app_sources})

target_include_directories(app PRIVATE
  ${ZEPHYR_BASE}/kernel/include
  ${ZEPHYR_BASE}/arch/${ARCH}/include
  )
```

## prj.conf
```kconfig
CONFIG_ZTEST=y
CONFIG_INIT_STACKS=y
CONFIG_THREAD_STACK_INFO=y
CONFIG_MAX_THREAD_BYTES=6
CONFIG_DYNAMIC_THREAD=y
CONFIG_DYNAMIC_THREAD_POOL_SIZE=2
CONFIG_DYNAMIC_THREAD_ALLOC=y
CONFIG_ZTEST_STACK_SIZE=2048
CONFIG_MAIN_STACK_SIZE=4096

CONFIG_HW_STACK_PROTECTION=n
CONFIG_TEST_HW_STACK_PROTECTION=n

CONFIG_DYNAMIC_OBJECTS=y

CONFIG_HEAP_MEM_POOL_SIZE=16384
```

## src/main.c
```c
/*
 * Copyright (c) 2026 University of Birmingham, support for CHERI
 *
 * SPDX-License-Identifier: Apache-2.0
 */

#include <zephyr/kernel.h>
#include <zephyr/ztest.h>
#include <zephyr/internal/syscall_handler.h>
#include <kernel_internal.h>

#include "func_defs.h"

/**
 * @brief Test zephyr dynamic stacks with CHERI memory alignment
 * and size rounding requirements to enforce CHERI bounds
 *
 * @defgroup cheri_dynamic_stack_tests CHERI Stack Dynamic Tests
 *
 * @ingroup cheri_tests
 *
 * This module tests the following stacks with CHERI
 *
 *     dynamic stacks allocated from a heap pool
 *     dynamic stacks allocated from the system heap
 *     using (dynamic.c)
 *
 */

/*
 * These tests validate that CHERI capability bounds are applied correctly
 * to dynamic stacks and when used in a thread.
 * Dynamic stacks are defined using either a stack heap pool via
 * K_HEAP_DEFINE, (CONFIG_DYNAMIC_THREAD_PREFER_POOL)
 * or from the system heap (CONFIG_DYNAMIC_THREAD_PREFER_ALLOC).
 * These are tested with:
 * test_dynamic_stack.c
 *   dynamic_stack_bounds_cheri_pool()
 *   dynamic_stack_bounds_cheri_sysheap()
 *
 * Tests are based on some tests from
 * tests/kernel/threads/dynamic_thread_stack and
 * tests/cheri/kernel/stack with CHERI specific additions.
 * It also tests different stack sizes for CHERI rounding.
 */

/**
 * @brief Show that the stack bounds are correct for CHERI
 *
 * Print and assert CHERI bounds of stacks allocated from a
 * heap pool.
 *
 * @ingroup cheri_dynamic_stack_tests
 */
ZTEST(cheri_dynamic_stack, test_dynamic_pool_stack_bounds_cheri)
{
dynamic_stack_bounds_cheri_pool();
}

/**
 * @brief Show that the stack bounds are correct for CHERI
 *
 * Print and assert CHERI bounds of stacks allocated from
 * the system heap.
 *
 * @ingroup cheri_dynamic_stack_tests
 */
ZTEST(cheri_dynamic_stack, test_dynamic_sysheap_stack_bounds_cheri)
{
dynamic_stack_bounds_cheri_sysheap();
}

ZTEST_SUITE(cheri_dynamic_stack, NULL, NULL,
		NULL, NULL, NULL);
```

## src/func_defs.h
```c
/*
 * Copyright (c) 2026 University of Birmingham, support for CHERI
 *
 * SPDX-License-Identifier: Apache-2.0
 */

#ifndef FUNC_DEFS_H
#define FUNC_DEFS_H

/* helper_funcs.h */

void assert_single_stack(char *cap,
			size_t size_bytes);

void assert_single_stack_sysheap(char *cap,
			size_t size_bytes);

void assert_thread_stack(char *cap,
			size_t size_bytes);

/* test_dynamic_stack.c */

void dynamic_stack_bounds_cheri_pool(void);
void dynamic_stack_bounds_cheri_sysheap(void);

#endif
```

## src/helper_funcs.c
```c
/*
 * Copyright (c) 2026 University of Birmingham, support for CHERI
 *
 * SPDX-License-Identifier: Apache-2.0
 */

#include <zephyr/kernel.h>
#include <zephyr/ztest.h>
#include <zephyr/internal/syscall_handler.h>
#include <kernel_internal.h>

#include "func_defs.h"

/*
 * CHERI helper assert functions
 *
 * These assert functions do CHERI bounds and alignment checks
 */

#ifdef __CHERI_PURE_CAPABILITY__

/* CHERI helper functions for printing and asserting bounds information */

/*
 * Note: not created as inline functions due to suspect compiler / qemu bug
 * returning __builtin_cheri_round_representable_length values
 * from incorrect arch when used inline.
 */

/* check single stack bounds */
void assert_single_stack(char *cap,
			size_t size_bytes)
{
	size_t cap_len  = __builtin_cheri_length_get(cap);
	uintptr_t cap_addr = __builtin_cheri_address_get(cap);
	uintptr_t cap_base = __builtin_cheri_base_get(cap);

	size_t size_expected = __builtin_cheri_round_representable_length((size_t)size_bytes);

	zassert_equal(cap_len, size_expected, "bounds of stack not match expected stack size");
	zassert_equal(cap_addr, cap_base, "address not aligned to base");
}

/* check single stack bounds for sysheap*/
/*
 * For sys heap allocation the exact bounds returned
 * is not deterministic because fragmentation
 * varies and what memory blocks are available
 * for allocation.
 * As a sanity check we can still check the bounds:
 * (1) should be at least cheri representable size
 * (should also be less than the sysheap size, but will fail long before reaching here)
 * (3) we can also check the alignment of the returned address
 */
void assert_single_stack_sysheap(char *cap,
			size_t size_bytes)
{
	size_t cap_len  = __builtin_cheri_length_get(cap);
	uintptr_t cap_addr = __builtin_cheri_address_get(cap);
	uintptr_t cap_base = __builtin_cheri_base_get(cap);

	/* minimum cheri representable size */
	size_t size_minimum_expected = __builtin_cheri_round_representable_length(
					(size_t)size_bytes);
	size_t align_minimum_expected = ~(__builtin_cheri_representable_alignment_mask(
					size_minimum_expected)) + 1;

	printk("size_minimum_expected: %zu\n", (size_t)size_minimum_expected);
	printk("align_minimum_expected: %zu\n", (size_t)align_minimum_expected);
	zassert_true(cap_len >= size_minimum_expected, "bounds of stack too small");

	zassert_true((cap_addr % align_minimum_expected) == 0,
		"base 0x%lx not aligned to %zu",
		cap_addr, align_minimum_expected);
}


/* check csp tightened bounds of stack in running thread */
/* address not likely be same as base since active csp */
void assert_thread_stack(char *cap,
			size_t size_bytes)
{
	size_t cap_len  = __builtin_cheri_length_get(cap);

	zassert_equal(cap_len, size_bytes, "bounds of stack not match stack size %zu, %zu",
		cap_len, size_bytes);
}

#endif
```

## src/test_dynamic_stack.c
```c
/*
 * Copyright (c) 2026 University of Birmingham, support for CHERI
 *
 * SPDX-License-Identifier: Apache-2.0
 */

#include <zephyr/kernel.h>
#include <zephyr/ztest.h>
#include <zephyr/internal/syscall_handler.h>
#include <kernel_internal.h>

#include "func_defs.h"

#ifdef __CHERI_PURE_CAPABILITY__
#include "inline_funcs.h"
#endif

#define POOL_SIZE 28672

#ifdef __CHERI_PURE_CAPABILITY__

#ifdef CONFIG_USERSPACE
#define STACK_OBJ_SIZE Z_THREAD_CHERI_REP_LEN(CONFIG_DYNAMIC_THREAD_STACK_SIZE)
#else
#define STACK_OBJ_SIZE Z_KERNEL_CHERI_REP_LEN(CONFIG_DYNAMIC_THREAD_STACK_SIZE)
#endif

#else

#ifdef CONFIG_USERSPACE
#define STACK_OBJ_SIZE K_THREAD_STACK_LEN(CONFIG_DYNAMIC_THREAD_STACK_SIZE)
#else
#define STACK_OBJ_SIZE K_KERNEL_STACK_LEN(CONFIG_DYNAMIC_THREAD_STACK_SIZE)
#endif

#endif /* __CHERI_PURE_CAPABILITY__ */

#define MAX_HEAP_STACKS (POOL_SIZE / STACK_OBJ_SIZE)

K_HEAP_DEFINE(stack_heap, POOL_SIZE);

/*
 * dynamic stack tests
 *
 * These tests validate that CHERI capability bounds are applied
 * correctly to dynamic stacks defined using either a stack heap via
 * K_HEAP_DEFINE, (CONFIG_DYNAMIC_THREAD_PREFER_POOL)
 * or from the system heap (CONFIG_DYNAMIC_THREAD_PREFER_ALLOC).
 * Tests are based on some tests from
 * tests/kernel/threads/dynamic_thread_stack with CHERI specific additions.
 * It also tests different stack sizes for CHERI rounding.
 */

/* helper functions for inspecting the stack csp thread */

/*
 * Arguments passed into the Zephyr thread entry functions require
 * void* parameters. We want to pass the stack size. In CHERI it is not
 * correct to turn integers into void* and back so create a structure
 * to be passed
 */
struct stest_params {
	size_t stack_size;
};
static struct stest_params global_params;


/*
 * Zephyr thread entry functions must have three void* args
 * even if not used. This executes on the thread’s context.
 * Here we can get the csp from the register and check its bounds
 * The asm instruction is only compatible with CHERI-RISCV
 */
void inspect_thread_stack_cap(void *a, void *b, void *c)
{

	/* get the stack size from the passed structure */
	struct stest_params *params = a;
	size_t stack_size = params->stack_size;

#ifdef __CHERI_PURE_CAPABILITY__

	TC_PRINT("Inside thread inspecting running stack capability\n");
	TC_PRINT("requested stack size: %zu\n", stack_size);

	size_t expected_stack_bounds = __builtin_cheri_round_representable_length(
					K_THREAD_STACK_LEN(stack_size));

	TC_PRINT("expected bounds size: %zu\n", expected_stack_bounds);

	/* Capture CSP capability on CHERI-RISCV only architecture */

	void *csp_cap;

	__asm__ volatile(STRINGIFY(M_CMOVE)" %0, csp" : "=C"(csp_cap) :: "memory");

	print_cheri("Thread capability stack pointer (CSP):\n", csp_cap);

	assert_thread_stack(csp_cap, expected_stack_bounds);
#endif
	/* Exit the thread */
	k_thread_abort(k_current_get());
}


/* functions used by z tests */


/*
 * Print and assert the bounds of stacks allocated from
 * an array pool in dynamic.c (CONFIG_DYNAMIC_THREAD_PREFER_POOL).
 */
void dynamic_stack_bounds_cheri_pool(void)
{

	if (!IS_ENABLED(CONFIG_DYNAMIC_THREAD_PREFER_POOL)) {
		ztest_test_skip();
	}

#ifdef __CHERI_PURE_CAPABILITY__
	TC_PRINT("CONFIG_DYNAMIC_THREAD_PREFER_POOL=y\n");
	TC_PRINT("CONFIG_DYNAMIC_THREAD_STACK_SIZE:%i\n", (int)CONFIG_DYNAMIC_THREAD_STACK_SIZE);
#else
	TC_PRINT("Non-CHERI mode, no bounds to test\n");
#endif

	/* Single stack allocation from pool for all threads */

	static k_tid_t tid[CONFIG_DYNAMIC_THREAD_POOL_SIZE];
	static struct k_thread th[CONFIG_DYNAMIC_THREAD_POOL_SIZE];
	static k_thread_stack_t *stack[CONFIG_DYNAMIC_THREAD_POOL_SIZE];

	/* allocate all thread stacks from the pool */

	for (size_t i = 0; i < CONFIG_DYNAMIC_THREAD_POOL_SIZE; ++i) {
		stack[i] = k_thread_stack_alloc(CONFIG_DYNAMIC_THREAD_STACK_SIZE,
						IS_ENABLED(CONFIG_USERSPACE) ? K_USER : 0);

		zassert_not_null(stack[i]);

#ifdef __CHERI_PURE_CAPABILITY__
		TC_PRINT("Stack: %i from pool\n", (int)i);

		assert_single_stack((char *)stack[i],
			CONFIG_DYNAMIC_THREAD_STACK_SIZE);

		print_cheri("", stack[i]);
#else
		TC_PRINT("stack_ptr=%p\n", stack[i]);
#endif
	}


	/* spawn our threads */
	TC_PRINT("........spawn threads........\n");
	for (size_t i = 0; i < CONFIG_DYNAMIC_THREAD_POOL_SIZE; ++i) {

		global_params.stack_size = CONFIG_DYNAMIC_THREAD_STACK_SIZE;

		tid[i] = k_thread_create(
				&th[i],
				stack[i],
				CONFIG_DYNAMIC_THREAD_STACK_SIZE,
				inspect_thread_stack_cap,      /* our inspector */
				&global_params, NULL, NULL,
				0,
				0,
				K_NO_WAIT
				);
	}

	/* join all threads */
	for (size_t i = 0; i < CONFIG_DYNAMIC_THREAD_POOL_SIZE; ++i) {
		zassert_ok(k_thread_join(tid[i], K_FOREVER));
	}

	/* clean up stacks allocated from the pool */
	for (size_t i = 0; i < CONFIG_DYNAMIC_THREAD_POOL_SIZE; ++i) {
		zassert_ok(k_thread_stack_free(stack[i]));
	}

}

/*
 * Print and assert the bounds of stacks allocated from
 * sys_heap in dynamic.c (CONFIG_DYNAMIC_THREAD_PREFER_ALLOC).
 */

void dynamic_stack_bounds_cheri_sysheap(void)
{

	if (!IS_ENABLED(CONFIG_DYNAMIC_THREAD_PREFER_ALLOC)) {
		ztest_test_skip();
	}

	if (!IS_ENABLED(CONFIG_DYNAMIC_THREAD_ALLOC)) {
		ztest_test_skip();
	}

#ifdef __CHERI_PURE_CAPABILITY__
	TC_PRINT("CONFIG_DYNAMIC_THREAD_PREFER_ALLOC=y\n");
	TC_PRINT("CONFIG_DYNAMIC_THREAD_STACK_SIZE:%i\n", (int)CONFIG_DYNAMIC_THREAD_STACK_SIZE);
#else
	TC_PRINT("Non-CHERI mode, no bounds to test\n");
#endif

	size_t N;
	static k_tid_t tid[MAX_HEAP_STACKS];
	static struct k_thread th[MAX_HEAP_STACKS];
	static k_thread_stack_t *stack[MAX_HEAP_STACKS];

	/* allocate all thread stacks from the heap */

	for (N = 0; N < MAX_HEAP_STACKS; ++N) {
		stack[N] = k_thread_stack_alloc(CONFIG_DYNAMIC_THREAD_STACK_SIZE,
						IS_ENABLED(CONFIG_USERSPACE) ? K_USER : 0);
		if (stack[N] == NULL) {

			break;
		}
#ifdef __CHERI_PURE_CAPABILITY__
		TC_PRINT("Stack: %i from heap\n", (int)N);

		assert_single_stack_sysheap((char *)stack[N],
			CONFIG_DYNAMIC_THREAD_STACK_SIZE);

		print_cheri("", stack[N]);
#endif
	}
	/* spawn our threads */
	TC_PRINT("........spawn threads........\n");
	for (N = 0; N < MAX_HEAP_STACKS; ++N) {
		if (stack[N] == NULL) {

			break;
		}

		global_params.stack_size = CONFIG_DYNAMIC_THREAD_STACK_SIZE;

		tid[N] = k_thread_create(
				&th[N],
				stack[N],
				CONFIG_DYNAMIC_THREAD_STACK_SIZE,
				inspect_thread_stack_cap,      /* our inspector */
				&global_params, NULL, NULL,
				0,
				0,
				K_NO_WAIT
				);
	}

	/* join all threads */
	for (N = 0; N < MAX_HEAP_STACKS; ++N) {
		if (stack[N] == NULL) {
			break;
		}
		zassert_ok(k_thread_join(tid[N], K_FOREVER));

	}

	/* clean up stacks allocated from the pool */
	for (N = 0; N < MAX_HEAP_STACKS; ++N) {
		if (stack[N] == NULL) {
			break;
		}
		zassert_ok(k_thread_stack_free(stack[N]));
	}

}
```
