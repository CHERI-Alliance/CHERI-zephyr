## CMakeLists.txt
```
# SPDX-License-Identifier: Apache-2.0

cmake_minimum_required(VERSION 3.20.0)
find_package(Zephyr REQUIRED HINTS $ENV{ZEPHYR_BASE})
project(stack)

FILE(GLOB app_sources src/*.c)
target_sources(app PRIVATE ${app_sources})

target_include_directories(app PRIVATE
  ${ZEPHYR_BASE}/kernel/include
  ${ZEPHYR_BASE}/arch/${ARCH}/include
  )
```

## prj.conf
```kconfig
CONFIG_ZTEST=y
CONFIG_INIT_STACKS=y
CONFIG_THREAD_STACK_INFO=y
CONFIG_TEST_USERSPACE=y
CONFIG_TRACING=y
```

## src/main.c
```c
/*
 * Copyright (c) 2026 University of Birmingham, support for CHERI
 *
 * SPDX-License-Identifier: Apache-2.0
 */

#include <zephyr/kernel.h>
#include <zephyr/ztest.h>
#include <zephyr/internal/syscall_handler.h>
#include <kernel_internal.h>

#include "func_defs.h"

/**
 * @brief Test zephyr stacks with CHERI memory alignment
 * and size rounding requirements to enforce CHERI bounds
 *
 * @defgroup cheri_stack_tests CHERI Stack Tests
 *
 * @ingroup cheri_tests
 *
 * This module tests the following stacks with CHERI
 *
 *     User stacks
 *     kernel stacks
 *     Idle stacks
 *   using (thread_stack.h)
 *	K_THREAD_STACK_DEFINE, K_THREAD_STACK_ARRAY_DEFINE
 *	K_KERNEL_STACK_DEFINE, K_KERNEL_STACK_ARRAY_DEFINE
 *   and tighening of bounds in
 *	arch_new_thread (arch/riscv/core/thread.c)
 *
 */

/* CHERI memory allocation alignment:
 * See CHERI C++ programming guide.
 * Due to CHERI bounds compression, not all memory allocation requests can be exactly
 * bound to the requested alignment and length. To obtain exact bounds requires
 * increasing alignment and rounding up the length.
 *
 * For CHERI, the stack macros in thread_stack.h have been modified to align and
 * round to CHERI requirements. Run-time bounds tightening of stack arrays is
 * done at run-time using the CHERI recommended builtins. This is done at thread
 * initialisation in arch_new_thread.
 *
 * test_stack_define.c
 *
 * These tests validate that CHERI capability bounds are applied correctly
 * to stacks defined using K_THREAD_STACK_DEFINE,
 * K_KERNEL_STACK_DEFINE, and their array variants. It also checks array bounds
 * are tightened on thread initialisation.
 * These are tested with:
 *   stack_bounds_cheri()
 *   stack_threads_bounds_cheri()
 *
 * test_idle_stack.c
 *
 * These tests validate that CHERI capability bounds are applied correctly
 * to idle stacks defined by the kernel using K_THREAD_STACK_DEFINE,
 * K_KERNEL_STACK_DEFINE, and their array variants. It also checks array bounds
 * are tightened on thread initialisation.
 * These are tested with:
 *   idle_stack_bounds_cheri()
 *   idle_csp_bounds_cheri()
 */

/**
 * @brief Show that the stack bounds are correct for CHERI
 *
 * Print and assert CHERI bounds of both single stacks and an array
 * of stacks. For the stack arrays the bounds will cover
 * the whole array and is created using K_KERNEL_STACK_DEFINE
 * and K_KERNEL_STACK_ARRAY_DEFINE
 *
 * @ingroup cheri_stack_tests
 */
ZTEST(cheri_stack, test_a_stack_bounds_cheri)
{
stack_bounds_cheri();
}

/**
 * @brief Show that the current thread stack bounds are tight
 *
 * Check the bounds of the current stack csp thread.
 * Here the bounds should be reduced to a single element
 * if running with SMP.
 *
 * @ingroup cheri_stack_tests
 */
ZTEST(cheri_stack, test_b_stack_threads_bounds_cheri)
{
stack_threads_bounds_cheri();
}

/**
 * @brief Show that the idle thread stack bounds is correct for CHERI
 *
 * Check the bounds of the current idle stack. If running with SMP
 * the bounds will cover the whole array and is created
 * using K_KERNEL_STACK_DEFINE & K_KERNEL_STACK_ARRAY_DEFINE
 *
 * @ingroup cheri_stack_tests
 */
ZTEST(cheri_stack, test_c_idle_stack_bounds_cheri)
{

idle_stack_bounds_cheri();
}

/**
 * @brief Show that the current idle thread stack bounds are tight
 *
 * Check the bounds of the current idle stack csp thread.
 * Here the bounds should be reduced to a single element
 * if running with SMP.
 *
 * @ingroup cheri_stack_tests
 */
ZTEST(cheri_stack, test_d_idle_csp_bounds_cheri)
{
idle_csp_bounds_cheri();
}

ZTEST_SUITE(cheri_stack, NULL, NULL,
		NULL, NULL, NULL);
```

## src/func_defs.h
```c
/*
 * Copyright (c) 2026 University of Birmingham, support for CHERI
 *
 * SPDX-License-Identifier: Apache-2.0
 */

#ifndef FUNC_DEFS_H
#define FUNC_DEFS_H

/* test inputs */

#define NUM_CPUS 2
#define NUM_STACKS 3
/* Choose a size that is likely to get rounded by CHERI representable length */
#if CONFIG_64BIT
#define STACK1 16389-CONFIG_TEST_EXTRA_STACK_SIZE
#else
#define STACK1 1032-CONFIG_TEST_EXTRA_STACK_SIZE
#endif
#define STEST_STACKSIZE (STACK1 + CONFIG_TEST_EXTRA_STACK_SIZE)

/* helper_funcs.h */

void assert_single_stack(char *cap,
			size_t size_bytes);

void assert_array_stack(int index,
			char *cap,
			size_t size_bytes);

void assert_thread_stack(char *cap,
			size_t size_bytes);

void assert_array_stack_idle(int index,
			char *cap,
			size_t size_bytes);

/* test_stack_define.c */

void stack_bounds_cheri(void);
void stack_threads_bounds_cheri(void);

/* test_idle_stack.c */

void idle_stack_bounds_cheri(void);
void idle_csp_bounds_cheri(void);

#endif
```

## src/helper_funcs.c
```c
/*
 * Copyright (c) 2026 University of Birmingham, support for CHERI
 *
 * SPDX-License-Identifier: Apache-2.0
 */

#include <zephyr/kernel.h>
#include <zephyr/ztest.h>
#include <zephyr/internal/syscall_handler.h>
#include <kernel_internal.h>

#include "func_defs.h"

/*
 * CHERI helper assert functions
 *
 * These assert functions do CHERI bounds and alignment checks
 */

#ifdef __CHERI_PURE_CAPABILITY__

/* CHERI helper functions for printing and asserting bounds information */

/*
 * Note: not created as inline functions due to suspect compiler / qemu bug
 * returning __builtin_cheri_round_representable_length values
 * from incorrect arch when used inline.
 */

/* check single stack bounds */
void assert_single_stack(char *cap,
			size_t size_bytes)
{
	size_t cap_len  = __builtin_cheri_length_get(cap);
	uintptr_t cap_addr = __builtin_cheri_address_get(cap);
	uintptr_t cap_base = __builtin_cheri_base_get(cap);

	zassert_equal(cap_len, size_bytes, "bounds of stack not match stack size");
	zassert_equal(cap_addr, cap_base, "address not aligned to base");
}

/*
 * check stack array bounds
 * bounds cover all elements of array
 * address depends on which array element is passed
 */
void assert_array_stack(int index,
			char *cap,
			size_t size_bytes)
{
	size_t cap_len  = __builtin_cheri_length_get(cap);
	uintptr_t cap_addr = __builtin_cheri_address_get(cap);
	uintptr_t cap_base = __builtin_cheri_base_get(cap);

	/*
	 * CHERI round up element size_bytes * NUM_STACKS.
	 * This is because the compiler rounds up macro array length to be a
	 * CHERI representable size, so we must do the same here in our test
	 */
	size_t expected_cap_len =
		__builtin_cheri_round_representable_length(size_bytes * NUM_STACKS);

	zassert_equal(cap_len, expected_cap_len,
		"bounds of stack not match expected size %zu, %zu",
			cap_len, expected_cap_len);
	zassert_equal(cap_addr, cap_base + (size_bytes * index),
		"address not aligned to expected");
}

/*
 * check stack array bounds
 * bounds cover all elements of array (CPUs)
 * address depends on which array element (CPU) is passed
 */
void assert_array_stack_idle(int index,
			char *cap,
			size_t size_bytes)
{
	size_t cap_len  = __builtin_cheri_length_get(cap);
	uintptr_t cap_addr = __builtin_cheri_address_get(cap);
	uintptr_t cap_base = __builtin_cheri_base_get(cap);

	/*
	 * CHERI round up element size_bytes * NUM_CPUS.
	 * This is because the compiler rounds up macro array length to be a
	 * CHERI representable size, so we must do the same here in our test
	 */
	size_t expected_cap_len = __builtin_cheri_round_representable_length(size_bytes * NUM_CPUS);

	zassert_equal(cap_len, expected_cap_len,
		"bounds of stack not match expected size %zu, %zu",
		cap_len, expected_cap_len);
	zassert_equal(cap_addr, cap_base + (size_bytes * index),
		"address not aligned to expected");
}

/* check csp tightened bounds of stack in running thread */
/* address not likely be same as base since active csp */
void assert_thread_stack(char *cap,
			size_t size_bytes)
{
	size_t cap_len  = __builtin_cheri_length_get(cap);

	zassert_equal(cap_len, size_bytes, "bounds of stack not match stack size %zu, %zu",
		cap_len, size_bytes);
}

#endif
```

## src/inline_funcs.h
```c
/*
 * Copyright (c) 2026 University of Birmingham, support for CHERI
 *
 * SPDX-License-Identifier: Apache-2.0
 */

#include <zephyr/tc_util.h>
#include <stdbool.h>
#include <zephyr/kernel.h>
#include <zephyr/ztest.h>

#ifdef __CHERI_PURE_CAPABILITY__

/* CHERI helper function for printing inline for performance and no call overhead */

static inline void print_cheri(const char *label, void *cap)
{
	uintptr_t cap_addr = __builtin_cheri_address_get(cap);
	uintptr_t cap_base = __builtin_cheri_base_get(cap);
	size_t cap_len  = __builtin_cheri_length_get(cap);
	size_t tag = __builtin_cheri_tag_get(cap);

	TC_PRINT("%s", label);
	TC_PRINT("CHERI addr:   0x%lx\n", (unsigned long)cap_addr);
	TC_PRINT("CHERI base:   0x%lx\n", (unsigned long)cap_base);
	TC_PRINT("CHERI top:   0x%lx\n", (unsigned long)cap_base+cap_len);
	TC_PRINT("CHERI length: %zu\n", cap_len);
	TC_PRINT("CHERI tag: %zu\n", tag);
}

#endif /* __CHERI_PURE_CAPABILITY__ */
```

## src/test_idle_stack.c
```c
/*
 * Copyright (c) 2026 University of Birmingham, support for CHERI
 *
 * SPDX-License-Identifier: Apache-2.0
 */

#include <zephyr/kernel.h>
#include <zephyr/ztest.h>
#include <zephyr/internal/syscall_handler.h>
#include <kernel_internal.h>
#include <zephyr/tracing/tracing.h>   /* declares sys_trace_idle() hook */

#include "func_defs.h"

#ifdef __CHERI_PURE_CAPABILITY__
#include "inline_funcs.h"
#endif

/*
 * IDLE stack tests
 *
 * These tests validate that CHERI capability bounds are applied correctly
 * to idle stacks defined by the kernel using K_THREAD_STACK_DEFINE,
 * K_KERNEL_STACK_DEFINE, and their array variants in
 * include/zephyr/kernel/thread_stack.h. It also checks array bounds
 * are tightened on thread initialisation in arch/riscv/core/thread.c
 */

/* helper functions for inspecting the idle stack csp thread */

#ifdef __CHERI_PURE_CAPABILITY__
/* check the csp is bounded with the expected size */
static int check_idle_thread_stack(const char *name, void *cap, size_t size_bytes)
{
	size_t cap_len  = __builtin_cheri_length_get(cap);

	/*
	 * Since this runs in the idle thread, we must not assert here.
	 * Instead return an error to be asserted later.
	 * we only check the size, we do not check the address is aligned to
	 * base since the thread is running and using the stack
	 * Also, since this runs in the idle thread, we must minimise printing.
	 */
	if (!(cap_len == size_bytes)) {
		printk("idle %s: cap_len=%zu expected=%zu\n",
			name, cap_len, size_bytes);
		return 1;
	}
	return 0;
}
#endif /* __CHERI_PURE_CAPABILITY__ */

/* Per-CPU observation flags, one flag: */
static atomic_t idle_seen_ok = ATOMIC_INIT(0);

/*
 * Zephyrs `tracing hook` called by the idle loop when CPU enters idle state
 * This executes on the idle thread’s context, so CSP is the idle CSP.
 * Here we can get the csp from the register and check its bounds
 * The asm instruction is only compatible with CHERI-RISCV
 */
void sys_trace_idle(void)
{
#ifdef __CHERI_PURE_CAPABILITY__

	/* Capture CSP capability on CHERI RISCV only architecture */

	void *csp_cap;

	__asm__ volatile(STRINGIFY(M_CMOVE) " %0, csp" : "=C"(csp_cap) :: "memory");

	/* Get the idle thread and id for the current CPU */
#ifdef CONFIG_SMP
	struct k_thread *idle = arch_curr_cpu()->idle_thread;
	unsigned int cpu_id = arch_curr_cpu()->id;
#else
	struct k_thread *idle = _current_cpu->idle_thread;
	unsigned int cpu_id = 0;
#endif /* CONFIG_SMP */

	/* return if already seen this cpu */
	if (atomic_get(&idle_seen_ok) & BIT(cpu_id)) {
		return;
	}

	if (idle != NULL) {
		size_t stack_size = idle->stack_info.size;
		/*
		 * Since this runs in the idle thread, we must minimise printing.
		 * printing here can cause issues.
		 * also we must not assert here.
		 */
		if (check_idle_thread_stack("csp", csp_cap, stack_size) < 1) {
			atomic_set(&idle_seen_ok, 1);
		}
	}
	return;
#else
	atomic_set(&idle_seen_ok, 1);
#endif /* __CHERI_PURE_CAPABILITY__ */
}


/* functions used by z tests */

/*
 * check the bounds of the current idle stack. If running with SMP
 * the bounds will cover the whole array and is created
 * using K_KERNEL_STACK_DEFINE & K_KERNEL_STACK_ARRAY_DEFINE
 */
void idle_stack_bounds_cheri(void)
{

TC_PRINT("Inspecting the idle stacks\n");

#ifdef __CHERI_PURE_CAPABILITY__
	TC_PRINT("Checking alignment and array sizes\n");
#else
	TC_PRINT("Non-CHERI mode, no bounds to test\n");
#endif /* __CHERI_PURE_CAPABILITY__ */

	/* Get the idle thread for the current CPU */
#ifdef CONFIG_SMP
	/* multicore */
	struct k_thread *idle = arch_curr_cpu()->idle_thread;
	unsigned int cpu_id = arch_curr_cpu()->id;
#else
	/* single core */
	struct k_thread *idle = _current_cpu->idle_thread;
#endif /* CONFIG_SMP */

	/* ensure stack is available */
	zassert_not_null(idle, "idle thread is NULL");

	/* get the idle thread’s stack info */
	char *start_cap = (char *)idle->stack_info.start;
	size_t stack_size = idle->stack_info.size;

#ifdef __CHERI_PURE_CAPABILITY__
	/* print and assert bounds */

	print_cheri("idle stack\n", start_cap);
	TC_PRINT("logical stack size %zu\n", stack_size);

#ifdef CONFIG_SMP
	assert_array_stack_idle(cpu_id,
			start_cap,
			stack_size);
#else
	assert_single_stack(start_cap,
			stack_size);
#endif /* CONFIG_SMP */
#endif /* __CHERI_PURE_CAPABILITY__ */
}

/*
 * check the bounds of the current idle stack csp thread.
 * here the bounds should be reduced to a single element
 * if running with SMP. This is done in riscv/core/thread.c
 *
 * This test simply waits a bit for idle to run and then
 * verifies bounds by hooking into the zephyr
 * sys_trace_idle function system hook to observe the
 * capability stack pointer (csp)
 */
void idle_csp_bounds_cheri(void)
{

	TC_PRINT("Inspecting the idle stacks stack pointer in thread\n");

#ifdef __CHERI_PURE_CAPABILITY__
#else
	TC_PRINT("Non-CHERI mode, no bounds to test\n");
#endif /* __CHERI_PURE_CAPABILITY__ */

	/* Give the system a moment to enter idle at least once */
	k_sleep(K_MSEC(5));
	zassert_true(atomic_get(&idle_seen_ok),
		"Idle CSP bounds hook did not observe expected bounds");
}
```

## src/test_stack_define.c
```c
/*
 * Copyright (c) 2026 University of Birmingham, support for CHERI
 *
 * SPDX-License-Identifier: Apache-2.0
 */

#include <zephyr/kernel.h>
#include <zephyr/ztest.h>
#include <zephyr/internal/syscall_handler.h>
#include <kernel_internal.h>

#include "func_defs.h"

#ifdef __CHERI_PURE_CAPABILITY__
#include "inline_funcs.h"
#endif


/*
 * USER/KERNEL stack tests
 *
 * These tests validate that CHERI capability bounds are applied correctly
 * to stacks defined using K_THREAD_STACK_DEFINE,
 * K_KERNEL_STACK_DEFINE, and their array variants in
 * include/zephyr/kernel/thread_stack.h. It also checks array bounds
 * are tightened on thread initialisation in arch/riscv/core/thread.c
 */

/* User thread stacks */
K_THREAD_STACK_DEFINE(user_stack, STEST_STACKSIZE);
K_THREAD_STACK_ARRAY_DEFINE(user_stack_array, NUM_STACKS, STEST_STACKSIZE);

/* Kernel thread stacks */
K_KERNEL_STACK_DEFINE(kern_stack, STEST_STACKSIZE);
K_KERNEL_STACK_ARRAY_DEFINE(kern_stack_array, NUM_STACKS, STEST_STACKSIZE);

struct k_thread test_thread;

/* helper functions for inspecting the stack csp thread */

/*
 * Arguments passed into the Zephyr thread entry functions require
 * void* parameters. We want to pass the stack size. In CHERI it is not
 * correct to turn integers into void* and back so create a structure
 * to be passed
 */
struct stest_params {
	size_t stack_size;
};
static struct stest_params global_params;


/*
 * Zephyr thread entry functions must have three void* args
 * even if not used. This executes on the thread’s context.
 * Here we can get the csp from the register and check its bounds
 * The asm instruction is only compatible with CHERI-RISCV
 */
void inspect_thread_stack_cap(void *a, void *b, void *c)
{

	/* get the stack size from the passed structure */
	struct stest_params *params = a;
	size_t stack_size = params->stack_size;

#ifdef __CHERI_PURE_CAPABILITY__

	TC_PRINT("Inside thread inspecting running stack capability\n");

	/* Capture CSP capability on CHERI-RISCV only architecture */

	void *csp_cap;

	__asm__ volatile(STRINGIFY(M_CMOVE)" %0, csp" : "=C"(csp_cap) :: "memory");

	print_cheri("Thread capability stack pointer (CSP):\n", csp_cap);

	assert_thread_stack(csp_cap, stack_size);
#endif
	/* Exit the thread */
	k_thread_abort(k_current_get());
}

/*
 * Inspect the stack bounds outside a thread
 * print the raw base pointer
 */
static void print_stack(const char *name,
			char *cap,
			size_t size_bytes)
{
	TC_PRINT("=== %s ===\n", name);
	TC_PRINT("Raw base pointer: %p\n", cap);

#ifdef __CHERI_PURE_CAPABILITY__
	print_cheri("", cap);
#endif
	TC_PRINT("Stack allocated size (bytes): %zu\n", size_bytes);
}


/* functions used by z tests */


/*
 * print and assert the bounds of both single stacks and an array
 * of stacks. For the stack arrays the bounds will cover
 * the whole array and is created using K_KERNEL_STACK_DEFINE
 * and K_KERNEL_STACK_ARRAY_DEFINE
 */
void stack_bounds_cheri(void)
{

#ifdef __CHERI_PURE_CAPABILITY__
	TC_PRINT("Testing CHERI modified stack macros in thread_stack.h\n");
	TC_PRINT("Checking alignment and array sizes\n");
#else
	TC_PRINT("Non-CHERI mode, no bounds to test\n");
#endif

	/* Single stacks */

	/*expect bounds to be the same as the allocated stack size */

	print_stack("user_stack",
		K_THREAD_STACK_BUFFER(user_stack),
		K_THREAD_STACK_SIZEOF(user_stack));
#ifdef __CHERI_PURE_CAPABILITY__
	assert_single_stack(
		K_THREAD_STACK_BUFFER(user_stack),
		K_THREAD_STACK_SIZEOF(user_stack));
#endif
	print_stack("kernel_stack",
		K_KERNEL_STACK_BUFFER(kern_stack),
		K_KERNEL_STACK_SIZEOF(kern_stack));
#ifdef __CHERI_PURE_CAPABILITY__
	assert_single_stack(
		K_KERNEL_STACK_BUFFER(kern_stack),
		K_KERNEL_STACK_SIZEOF(kern_stack));
#endif

	/* Arrayed stacks */

	/* expect bounds to be the fully allocated array CHERI_round(stack size * NUM_STACKS) */

	/* user stack array */
	for (int i = 0; i < NUM_STACKS; i++) {
		char name_user[32];

		snprintf(name_user, sizeof(name_user),
			"user_stack_array[%d]", i);
		/* returns with bounds of whole buffer */
		/* can't shrink bounds in macro because used in kernel setup */
		print_stack(name_user,
			K_THREAD_STACK_BUFFER(user_stack_array[i]),
			K_THREAD_STACK_SIZEOF(user_stack_array[i]));
#ifdef __CHERI_PURE_CAPABILITY__
		assert_array_stack(i,
			K_THREAD_STACK_BUFFER(user_stack_array[i]),
			K_THREAD_STACK_SIZEOF(user_stack_array[i]));
#endif
	}

	/* kernel stack array */
	for (int i = 0; i < NUM_STACKS; i++) {
		char name_kern[34];

		snprintf(name_kern, sizeof(name_kern),
			"kernel_stack_array[%d]", i);
		/* returns with bounds of whole buffer */
		/* can't shrink bounds in macro because used in kernel setup */
		print_stack(name_kern,
			K_KERNEL_STACK_BUFFER(kern_stack_array[i]),
			K_KERNEL_STACK_SIZEOF(kern_stack_array[i]));
#ifdef __CHERI_PURE_CAPABILITY__
		assert_array_stack(i,
			K_THREAD_STACK_BUFFER(user_stack_array[i]),
			K_THREAD_STACK_SIZEOF(user_stack_array[i]));
#endif
	}
}

/*
 * check the bounds of the current stack csp thread.
 * here the bounds should be reduced to a single element
 * if running with SMP. This is done in riscv/core/thread.c
 *
 * This test uses the inspect_thread_stack_cap
 * entry function to enter the thread and observe the
 * capability stack pointer (csp). The bounds
 * are checked against the expected size.
 */
void stack_threads_bounds_cheri(void)
{

#ifdef __CHERI_PURE_CAPABILITY__
	TC_PRINT("Testing tight bounds of individual array stacks in riscv/core/thread.c\n");
#else
	TC_PRINT("Non-CHERI mode, no bounds to test\n");
#endif

	/* user thread - check bounds are tightened per element of array */

	TC_PRINT("=== Creating threads on user_stack_array ===\n");

	for (int i = 0; i < NUM_STACKS; i++) {
		static size_t stack_size = K_THREAD_STACK_SIZEOF(user_stack_array[i]);
		/* In cheri we can't turn integers into void* and back */
	       global_params.stack_size = stack_size;

		TC_PRINT("stack array [%d]\n", i);
		k_tid_t tid = k_thread_create(
		&test_thread,
		user_stack_array[i],
		stack_size,
		inspect_thread_stack_cap,      /* our inspector */
		&global_params, NULL, NULL,
		0,
		0,
		K_NO_WAIT
		);
		k_thread_join(tid, K_FOREVER);
	}

	/* kernel thread - check bounds are tightened per element of array */

	TC_PRINT("=== Creating threads on kernel_stack_array ===\n");

	for (int i = 0; i < NUM_STACKS; i++) {
		static size_t stack_size = K_KERNEL_STACK_SIZEOF(kern_stack_array[i]);
		/* In cheri we can't turn integers into void* and back */
	       global_params.stack_size = stack_size;

		TC_PRINT("stack array [%d]\n", i);
		k_tid_t tid = k_thread_create(
		&test_thread,
		kern_stack_array[i],
		stack_size,
		inspect_thread_stack_cap,      /* our inspector */
		&global_params, NULL, NULL,
		0,
		0,
		K_NO_WAIT
		);
		k_thread_join(tid, K_FOREVER);
	}
}
```
