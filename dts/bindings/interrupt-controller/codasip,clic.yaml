## samples/basic/sys_heap/sample.yaml
```yaml
sample:
  description: System heap sample showing how to use sys_heap functions
  name: Basic system heap sample
common:
  integration_platforms:
    - native_sim
tests:
  sample.basic.sys_heap:
    tags:
      - heap
      - statistics
      - dynamic_memory
    harness: console
    harness_config:
      type: multi_line
      ordered: true
      regex:
        - ".*allocated 15.,.*"
        - ".*allocated 10.,.*"
        - ".*allocated 0, free ..., max allocated ..., heap size 256.*"
    platform_exclude:
      - qemu_riscv32cheri_purecap
      - qemu_riscv32cheri_zcheripurecap
      - qemu_riscv32cheri_smp_purecap
      - qemu_riscv32cheri_smp_zcheripurecap
      - qemu_riscv64cheri_purecap
      - qemu_riscv64cheri_zcheripurecap
      - qemu_riscv64cheri_smp_purecap
      - qemu_riscv64cheri_smp_zcheripurecap
  sample.basic.sys_heap_cheri32:
    tags:
      - heap
      - statistics
      - dynamic_memory
      - cheri
    toolchain_allow:
      - llvm-cheri
    platform_allow:
      - qemu_riscv32cheri_purecap
      - qemu_riscv32cheri_zcheripurecap
      - qemu_riscv32cheri_smp_purecap
      - qemu_riscv32cheri_smp_zcheripurecap
    harness: console
    harness_config:
      type: multi_line
      ordered: true
      regex:
        - ".*allocated 1..,.*"
        - ".*allocated 104,.*"
        - ".*allocated 0, free ..., max allocated ..., heap size 512.*"
  sample.basic.sys_heap_cheri64:
    tags:
      - heap
      - statistics
      - dynamic_memory
      - cheri
    toolchain_allow:
      - llvm-cheri
    platform_allow:
      - qemu_riscv64cheri_purecap
      - qemu_riscv64cheri_zcheripurecap
      - qemu_riscv64cheri_smp_purecap
      - qemu_riscv64cheri_smp_zcheripurecap
    harness: console
    harness_config:
      type: multi_line
      ordered: true
      regex:
        - ".*allocated 160,.*"
        - ".*allocated 112,.*"
        - ".*allocated 0, free ..., max allocated ..., heap size 512.*"
```

## samples/cheri/buffer_overflow/sample.yaml
```yaml
sample:
  description: CHERI showing hardware exception
  name: CHERI buffer overflow
common:
  tags: cheri
  harness: console
  harness_config:
    type: one_line
    regex:
      - "Sample finished"
tests:
  samples.cheri.buffer_overflow:
    tags: cheri
    toolchain_allow:
      - llvm-cheri
    platform_allow:
      - qemu_riscv64cheri
      - qemu_riscv32cheri
      - qemu_riscv64cheri_purecap
      - qemu_riscv32cheri_purecap
      - qemu_riscv64cheri_zcheripurecap
      - qemu_riscv32cheri_zcheripurecap
      - qemu_riscv64cheri_smp_purecap
      - qemu_riscv32cheri_smp_purecap
      - qemu_riscv64cheri_smp_zcheripurecap
      - qemu_riscv32cheri_smp_zcheripurecap
```

## samples/cheri/mem_slab_overflow/sample.yaml
```yaml
sample:
  description: CHERI showing hardware exception
  name: CHERI mem_slab overflow
common:
  tags: cheri
  harness: console
  harness_config:
    type: one_line
    regex:
      - "Sample finished"
tests:
  samples.cheri.mem_slab_overflow:
    tags: cheri
    toolchain_allow:
      - llvm-cheri
    platform_allow:
      - qemu_riscv64cheri
      - qemu_riscv32cheri
      - qemu_riscv64cheri_purecap
      - qemu_riscv32cheri_purecap
      - qemu_riscv64cheri_zcheripurecap
      - qemu_riscv32cheri_zcheripurecap
      - qemu_riscv64cheri_smp_purecap
      - qemu_riscv32cheri_smp_purecap
      - qemu_riscv64cheri_smp_zcheripurecap
      - qemu_riscv32cheri_smp_zcheripurecap
```

## soc/codasip/Kconfig
```kconfig
# Copyright (c) 2026 University of Birmingham
# SPDX-License-Identifier: Apache-2.0

#selections for all socs in family
config SOC_FAMILY_HOBGOBLIN
	select ATOMIC_OPERATIONS_BUILTIN
	select INCLUDE_RESET_VECTOR
	select RISCV_ISA_EXT_M
	select RISCV_ISA_EXT_A
	select RISCV_ISA_EXT_C
	select RISCV
	select RISCV_PRIVILEGED
	select RISCV_HAS_PLIC
	select RISCV_SOC_HAS_GP_RELATIVE_ADDRESSING
	imply XIP

if SOC_FAMILY_HOBGOBLIN

# specific selections for each soc in family
rsource "*/Kconfig"

endif
```

## soc/codasip/Kconfig.defconfig
```kconfig
# Copyright (c) 2026 University of Birmingham
# SPDX-License-Identifier: Apache-2.0

if SOC_FAMILY_HOBGOBLIN

#configs for all socs in family

#add individual socs
rsource "*/Kconfig.defconfig"

endif
```

## soc/codasip/Kconfig.soc
```kconfig
# Copyright (c) 2026 University of Birmingham
# SPDX-License-Identifier: Apache-2.0

config SOC_FAMILY_HOBGOBLIN
	bool

config SOC_FAMILY
	default "hobgoblin" if SOC_FAMILY_HOBGOBLIN

rsource "*/Kconfig.soc"
```

## soc/codasip/hobgoblin_v739_riscv32cheri/Kconfig
```kconfig
# Copyright (c) 2026 University of Birmingham
# SPDX-License-Identifier: Apache-2.0

config SOC_HOBGOBLIN_V739_RISCV32CHERI
	select CPU_HAS_FPU
	select RISCV_ISA_RV32I
	select RISCV_ISA_EXT_ZICSR
	select RISCV_ISA_EXT_ZIFENCEI
	select RISCV_HAS_CLIC
```

## soc/codasip/hobgoblin_v739_riscv32cheri/Kconfig.soc
```kconfig
# Copyright (c) 2026 University of Birmingham
# SPDX-License-Identifier: Apache-2.0

config SOC_HOBGOBLIN_V739_RISCV32CHERI
	bool
	select SOC_FAMILY_HOBGOBLIN

config SOC
	default "hobgoblin_v739_riscv32cheri" if SOC_HOBGOBLIN_V739_RISCV32CHERI
```

## soc/codasip/hobgoblin_x730-mp4_riscv64cheri/Kconfig
```kconfig
# Copyright (c) 2026 University of Birmingham
# SPDX-License-Identifier: Apache-2.0

config SOC_HOBGOBLIN_X730_MP4_RISCV64CHERI
	select 64BIT
	select CPU_HAS_FPU_DOUBLE_PRECISION
	select RISCV_ISA_RV64I
	select RISCV_ISA_EXT_ZICSR
	select RISCV_ISA_EXT_ZIFENCEI
```

## soc/codasip/hobgoblin_x730-mp4_riscv64cheri/Kconfig.defconfig
```kconfig
# Copyright (c) 2026 University of Birmingham
# SPDX-License-Identifier: Apache-2.0

#configs for 64 bit only

if SOC_HOBGOBLIN_X730_MP4_RISCV64CHERI

config SYS_CLOCK_HW_CYCLES_PER_SEC
	default 100000000

config SYS_CLOCK_TICKS_PER_SEC
	default 1

config RISCV_SOC_INTERRUPT_INIT
	default y

config 2ND_LVL_ISR_TBL_OFFSET
	default 12

config 2ND_LVL_INTR_00_OFFSET
	default 11

config 2ND_LEVEL_INTERRUPT_BITS
	default 11

config MAX_IRQ_PER_AGGREGATOR
	default 52

config NUM_IRQS
	default 64

config FPU
	default y if CPU_HAS_FPU

endif
```

## soc/codasip/hobgoblin_x730-mp4_riscv64cheri/Kconfig.soc
```kconfig
# Copyright (c) 2026 University of Birmingham
# SPDX-License-Identifier: Apache-2.0

config SOC_HOBGOBLIN_X730_MP4_RISCV64CHERI
	bool
	select SOC_FAMILY_HOBGOBLIN

config SOC
	default "hobgoblin_x730_mp4_riscv64cheri" if SOC_HOBGOBLIN_X730_MP4_RISCV64CHERI
```

## tests/cheri/kernel/dynamic_stack/testcase.yaml
```yaml
common:
  tags:
    - cheri
    - kernel
    - security
    - userspace
  toolchain_allow:
    - llvm-cheri
  platform_allow:
    - qemu_riscv32cheri
    - qemu_riscv32cheri_smp
    - qemu_riscv64cheri
    - qemu_riscv64cheri_smp
    - qemu_riscv64cheri_purecap
    - qemu_riscv32cheri_purecap
    - qemu_riscv64cheri_zcheripurecap
    - qemu_riscv32cheri_zcheripurecap
    - qemu_riscv64cheri_smp_purecap
    - qemu_riscv32cheri_smp_purecap
    - qemu_riscv64cheri_smp_zcheripurecap
    - qemu_riscv32cheri_smp_zcheripurecap
tests:
  cheri.kernel.dynamic.stack.sysheap:
    extra_configs:
      - CONFIG_DYNAMIC_THREAD_POOL_SIZE=2
      - CONFIG_DYNAMIC_THREAD_ALLOC=y
      - CONFIG_DYNAMIC_THREAD_PREFER_ALLOC=y
      - CONFIG_DYNAMIC_THREAD_STACK_SIZE=2048
  cheri.kernel.dynamic.stack.pool:
    extra_configs:
      - CONFIG_DYNAMIC_THREAD_POOL_SIZE=2
      - CONFIG_DYNAMIC_THREAD_ALLOC=n
      - CONFIG_DYNAMIC_THREAD_PREFER_ALLOC=n
      - CONFIG_DYNAMIC_THREAD_STACK_SIZE=2048
  cheri.kernel.dynamic.stack.sysheap.small:
    extra_configs:
      - CONFIG_DYNAMIC_THREAD_POOL_SIZE=2
      - CONFIG_DYNAMIC_THREAD_ALLOC=y
      - CONFIG_DYNAMIC_THREAD_PREFER_ALLOC=y
      - CONFIG_DYNAMIC_THREAD_STACK_SIZE=2000
  cheri.kernel.dynamic.stack.pool.small:
    extra_configs:
      - CONFIG_DYNAMIC_THREAD_POOL_SIZE=2
      - CONFIG_DYNAMIC_THREAD_ALLOC=n
      - CONFIG_DYNAMIC_THREAD_PREFER_ALLOC=n
      - CONFIG_DYNAMIC_THREAD_STACK_SIZE=2000
  cheri.kernel.dynamic.stack.sysheap.large:
    extra_configs:
      - CONFIG_DYNAMIC_THREAD_POOL_SIZE=2
      - CONFIG_DYNAMIC_THREAD_ALLOC=y
      - CONFIG_DYNAMIC_THREAD_PREFER_ALLOC=y
      - CONFIG_DYNAMIC_THREAD_STACK_SIZE=8000
  cheri.kernel.dynamic.stack.pool.large:
    extra_configs:
      - CONFIG_DYNAMIC_THREAD_POOL_SIZE=2
      - CONFIG_DYNAMIC_THREAD_ALLOC=n
      - CONFIG_DYNAMIC_THREAD_PREFER_ALLOC=n
      - CONFIG_DYNAMIC_THREAD_STACK_SIZE=8000
```

## tests/cheri/kernel/mem_heap/k_heap_api/testcase.yaml
```yaml
tests:
  cheri.kernel.k_heap_api:
    tags:
      - heap
      - kernel
      - cheri
    toolchain_allow:
      - llvm-cheri
    platform_allow:
      - qemu_riscv64cheri
      - qemu_riscv32cheri
      - qemu_riscv64cheri_smp
      - qemu_riscv32cheri_smp
      - qemu_riscv64cheri_purecap
      - qemu_riscv32cheri_purecap
      - qemu_riscv64cheri_zcheripurecap
      - qemu_riscv32cheri_zcheripurecap
      - qemu_riscv64cheri_smp_purecap
      - qemu_riscv64cheri_smp_zcheripurecap
      - qemu_riscv32cheri_smp_purecap
      - qemu_riscv32cheri_smp_zcheripurecap
```

## tests/cheri/kernel/mem_slab/mslab_slab_bounds/testcase.yaml
```yaml
tests:
  cheri.kernel.memory_slabs_bounds:
    tags:
      - cheri
      - kernel
      - memory_slabs
    toolchain_allow:
      - llvm-cheri
    platform_allow:
      - qemu_riscv64cheri
      - qemu_riscv32cheri
      - qemu_riscv64cheri_smp
      - qemu_riscv32cheri_smp
      - qemu_riscv64cheri_purecap
      - qemu_riscv32cheri_purecap
      - qemu_riscv64cheri_zcheripurecap
      - qemu_riscv32cheri_zcheripurecap
      - qemu_riscv32cheri_smp_purecap
      - qemu_riscv32cheri_smp_zcheripurecap
  cheri.kernel.memory_slabs_bounds.relax:
    tags:
      - cheri
      - kernel
      - memory_slabs
    toolchain_allow:
      - llvm-cheri
    platform_allow:
      - qemu_riscv64cheri
      - qemu_riscv32cheri
      - qemu_riscv64cheri_smp
      - qemu_riscv32cheri_smp
      - qemu_riscv64cheri_purecap
      - qemu_riscv32cheri_purecap
      - qemu_riscv64cheri_zcheripurecap
      - qemu_riscv32cheri_zcheripurecap
      - qemu_riscv64cheri_smp_purecap
      - qemu_riscv32cheri_smp_purecap
      - qemu_riscv64cheri_smp_zcheripurecap
      - qemu_riscv32cheri_smp_zcheripurecap
    extra_configs:
      - CONFIG_CHERI_MEM_SLAB_RELAX_BLK_BOUNDS=y
  cheri.kernel.memory_slabs_bounds.reduced:
    tags:
      - cheri
      - kernel
      - memory_slabs
    toolchain_allow:
      - llvm-cheri
    platform_allow:
      - qemu_riscv64cheri
      - qemu_riscv32cheri
      - qemu_riscv64cheri_smp
      - qemu_riscv32cheri_smp
      - qemu_riscv64cheri_purecap
      - qemu_riscv32cheri_purecap
      - qemu_riscv64cheri_zcheripurecap
      - qemu_riscv32cheri_zcheripurecap
      - qemu_riscv64cheri_smp_purecap
      - qemu_riscv32cheri_smp_purecap
      - qemu_riscv64cheri_smp_zcheripurecap
      - qemu_riscv32cheri_smp_zcheripurecap
    extra_configs:
      - CONFIG_CHERI_MEM_SLAB_NUM_BLKS_REDUCE=y
```

## tests/cheri/kernel/stack/testcase.yaml
```yaml
tests:
  cheri.kernel.stack:
    tags:
      - cheri
      - kernel
      - security
      - userspace
    toolchain_allow:
      - llvm-cheri
    platform_allow:
      - qemu_riscv32cheri
      - qemu_riscv32cheri_smp
      - qemu_riscv64cheri_purecap
      - qemu_riscv32cheri_purecap
      - qemu_riscv64cheri_zcheripurecap
      - qemu_riscv32cheri_zcheripurecap
      - qemu_riscv64cheri_smp_purecap
      - qemu_riscv32cheri_smp_purecap
      - qemu_riscv64cheri_smp_zcheripurecap
      - qemu_riscv32cheri_smp_zcheripurecap
```

## tests/cheri/lib/c_lib/common/testcase.yaml
```yaml
common:
  tags:
    - cheri
    - clib
  toolchain_allow:
    - llvm-cheri
  platform_allow:
    - qemu_riscv64cheri
    - qemu_riscv32cheri
    - qemu_riscv64cheri_smp
    - qemu_riscv32cheri_smp
    - qemu_riscv64cheri_purecap
    - qemu_riscv32cheri_purecap
    - qemu_riscv64cheri_zcheripurecap
    - qemu_riscv32cheri_zcheripurecap
    - qemu_riscv32cheri_smp_purecap
    - qemu_riscv32cheri_smp_zcheripurecap
    - qemu_riscv64cheri_smp_purecap
    - qemu_riscv64cheri_smp_zcheripurecap
tests:
  cheri.libraries.libc.common: {}
  cheri.libraries.libc.common.minimal:
    filter: CONFIG_MINIMAL_LIBC_SUPPORTED
    tags: minimal_libc
    extra_configs:
      - CONFIG_MINIMAL_LIBC=y
      - CONFIG_MINIMAL_LIBC_NON_REENTRANT_FUNCTIONS=y
      - CONFIG_MINIMAL_LIBC_RAND=y
```

## tests/cheri/lib/heap_align/testcase.yaml
```yaml
tests:
  cheri.libraries.sys_heap_align:
    tags:
      - cheri
      - heap
      - heap_align
    toolchain_allow:
      - llvm-cheri
    platform_allow:
      - qemu_riscv64cheri
      - qemu_riscv32cheri
      - qemu_riscv64cheri_smp
      - qemu_riscv32cheri_smp
      - qemu_riscv64cheri_purecap
      - qemu_riscv32cheri_purecap
      - qemu_riscv64cheri_zcheripurecap
      - qemu_riscv32cheri_zcheripurecap
      - qemu_riscv32cheri_smp_purecap
      - qemu_riscv32cheri_smp_zcheripurecap
      - qemu_riscv64cheri_smp_purecap
      - qemu_riscv64cheri_smp_zcheripurecap
    timeout: 480
```

## tests/cheri/lib/mem_blocks/testcase.yaml
```yaml
tests:
  cheri.libraries.mem_blocks:
    tags:
      - cheri
      - heap
      - mem_blocks
    toolchain_allow:
      - llvm-cheri
    platform_allow:
      - qemu_riscv64cheri
      - qemu_riscv32cheri
      - qemu_riscv64cheri_smp
      - qemu_riscv32cheri_smp
      - qemu_riscv64cheri_purecap
      - qemu_riscv32cheri_purecap
      - qemu_riscv64cheri_zcheripurecap
      - qemu_riscv32cheri_zcheripurecap
      - qemu_riscv32cheri_smp_purecap
      - qemu_riscv32cheri_smp_zcheripurecap
```

## tests/cheri/lib/multi_heap/testcase.yaml
```yaml
tests:
  cheri.libraries.multi_heap:
    tags:
      - multi_heap
      - cheri
    toolchain_allow:
      - llvm-cheri
    platform_allow:
      - qemu_riscv32cheri
      - qemu_riscv64cheri
      - qemu_riscv32cheri_smp
      - qemu_riscv64cheri_smp
      - qemu_riscv32cheri_purecap
      - qemu_riscv64cheri_purecap
      - qemu_riscv32cheri_zcheripurecap
      - qemu_riscv64cheri_zcheripurecap
      - qemu_riscv32cheri_smp_purecap
      - qemu_riscv64cheri_smp_purecap
      - qemu_riscv32cheri_smp_zcheripurecap
      - qemu_riscv64cheri_smp_zcheripurecap
    extra_configs:
      - CONFIG_IRQ_OFFLOAD=y
  cheri.libraries.multi_heap.no_mt:
    tags:
      - multi_heap
      - cheri
    toolchain_allow:
      - llvm-cheri
    platform_allow:
      - qemu_riscv32cheri
      - qemu_riscv64cheri
      - qemu_riscv32cheri_smp
      - qemu_riscv64cheri_smp
      - qemu_riscv32cheri_smp_purecap
      - qemu_riscv64cheri_smp_purecap
      - qemu_riscv32cheri_smp_zcheripurecap
      - qemu_riscv64cheri_smp_zcheripurecap
    extra_configs:
      - CONFIG_MULTITHREADING=n
```
