## boards/riscv/qemu_riscv64cheri/Kconfig.board
```kconfig
# SPDX-License-Identifier: Apache-2.0
# Modified for CHERI 2025 by University of Birmingham

config BOARD_QEMU_RISCV64CHERI
	bool "QEMU RISCV64CHERI target"
	depends on SOC_RISCV_VIRT
	select QEMU_TARGET
	select 64BIT
	select HAS_COVERAGE_SUPPORT
	select CPU_HAS_FPU_DOUBLE_PRECISION
	select RISCV_ISA_RV64I
	select RISCV_ISA_EXT_ZICSR
	select RISCV_ISA_EXT_ZIFENCEI

config BOARD_QEMU_RISCV64CHERI_PURECAP
	bool "QEMU RISCV64CHERI PURECAP target"
	depends on SOC_RISCV_VIRT
	select QEMU_TARGET
	select 64BIT
	select HAS_COVERAGE_SUPPORT
	select CPU_HAS_FPU_DOUBLE_PRECISION
	select RISCV_ISA_RV64I
	select RISCV_ISA_EXT_ZICSR
	select RISCV_ISA_EXT_ZIFENCEI

config BOARD_QEMU_RISCV64CHERI_SMP
	bool "QEMU RISCV64CHERI SMP target"
	depends on SOC_RISCV_VIRT
	select QEMU_TARGET
	select 64BIT
	select HAS_COVERAGE_SUPPORT
	select CPU_HAS_FPU_DOUBLE_PRECISION
	select RISCV_ISA_RV64I
	select RISCV_ISA_EXT_ZICSR
	select RISCV_ISA_EXT_ZIFENCEI

config BOARD_QEMU_RISCV64CHERI_SMP_PURECAP
	bool "QEMU RISCV64CHERI SMP PURECAP target"
	depends on SOC_RISCV_VIRT
	select QEMU_TARGET
	select 64BIT
	select HAS_COVERAGE_SUPPORT
	select CPU_HAS_FPU_DOUBLE_PRECISION
	select RISCV_ISA_RV64I
	select RISCV_ISA_EXT_ZICSR
	select RISCV_ISA_EXT_ZIFENCEI

config BOARD_QEMU_RISCV64CHERI_ZCHERIPURECAP
	bool "QEMU RISCV64CHERI ZCHERIPURECAP target"
	depends on SOC_RISCV_VIRT
	select QEMU_TARGET
	select 64BIT
	select HAS_COVERAGE_SUPPORT
	select CPU_HAS_FPU_DOUBLE_PRECISION
	select RISCV_ISA_RV64I
	select RISCV_ISA_EXT_ZICSR
	select RISCV_ISA_EXT_ZIFENCEI

config BOARD_QEMU_RISCV64CHERI_SMP_ZCHERIPURECAP
	bool "QEMU RISCV64CHERI SMP ZCHERIPURECAP target"
	depends on SOC_RISCV_VIRT
	select QEMU_TARGET
	select 64BIT
	select HAS_COVERAGE_SUPPORT
	select CPU_HAS_FPU_DOUBLE_PRECISION
	select RISCV_ISA_RV64I
	select RISCV_ISA_EXT_ZICSR
	select RISCV_ISA_EXT_ZIFENCEI
```

## boards/riscv/qemu_riscv64cheri/Kconfig.defconfig
```kconfig
# SPDX-License-Identifier: Apache-2.0
# Modified for CHERI 2025 by University of Birmingham

config BUILD_OUTPUT_BIN
	default n

config BOARD
	default "qemu_riscv64cheri" if BOARD_QEMU_RISCV64CHERI
	default "qemu_riscv64cheri_purecap" if BOARD_QEMU_RISCV64CHERI_PURECAP
	default "qemu_riscv64cheri_smp" if BOARD_QEMU_RISCV64CHERI_SMP
	default "qemu_riscv64cheri_smp_purecap" if BOARD_QEMU_RISCV64CHERI_SMP_PURECAP
	default "qemu_riscv64cheri_zcheripurecap" if BOARD_QEMU_RISCV64CHERI_ZCHERIPURECAP
	default "qemu_riscv64cheri_smp_zcheripurecap" if BOARD_QEMU_RISCV64CHERI_SMP_ZCHERIPURECAP
```

## boards/riscv/qemu_riscv64cheri/qemu_riscv64cheri_smp_purecap_defconfig
```kconfig
# SPDX-License-Identifier: Apache-2.0
# Modified for CHERI 2024 by Birmingham University

CONFIG_SOC_SERIES_RISCV_VIRT=y
CONFIG_SOC_RISCV_VIRT=y
CONFIG_BOARD_QEMU_RISCV64CHERI_SMP_PURECAP=y
CONFIG_PRIVILEGED_STACK_SIZE=4096
CONFIG_CONSOLE=y
CONFIG_SERIAL=y
CONFIG_UART_CONSOLE=y
CONFIG_STACK_SENTINEL=y
CONFIG_XIP=n
CONFIG_SMP=y
CONFIG_MP_MAX_NUM_CPUS=2
CONFIG_QEMU_ICOUNT=n

CONFIG_IDLE_STACK_SIZE=2048
CONFIG_RISCV_PMP=y
CONFIG_TICKET_SPINLOCKS=y

#compile for cheri purecap
CONFIG_CHERI=y
CONFIG_ISR_TABLE_USE_SYMBOLS=y
```

## boards/riscv/qemu_riscv64cheri/qemu_riscv64cheri_smp_zcheripurecap_defconfig
```kconfig
# SPDX-License-Identifier: Apache-2.0
# Modified for CHERI 2025 by Birmingham University

CONFIG_SOC_SERIES_RISCV_VIRT=y
CONFIG_SOC_RISCV_VIRT=y
CONFIG_BOARD_QEMU_RISCV64CHERI_SMP_ZCHERIPURECAP=y
CONFIG_PRIVILEGED_STACK_SIZE=4096
CONFIG_CONSOLE=y
CONFIG_SERIAL=y
CONFIG_UART_CONSOLE=y
CONFIG_STACK_SENTINEL=y
CONFIG_XIP=n
CONFIG_SMP=y
CONFIG_MP_MAX_NUM_CPUS=2
CONFIG_QEMU_ICOUNT=n

CONFIG_IDLE_STACK_SIZE=2048
CONFIG_RISCV_PMP=n
CONFIG_TICKET_SPINLOCKS=y

#compile for cheri purecap
CONFIG_CHERI=y
CONFIG_ISR_TABLE_USE_SYMBOLS=y
CONFIG_RISCV_ISA_ZCHERIPURECAP_ABI=y
```

## boards/riscv/qemu_riscv64cheri/qemu_riscv64cheri_zcheripurecap_defconfig
```kconfig
# SPDX-License-Identifier: Apache-2.0
# Modified for CHERI 2025 by University of Birmingham

CONFIG_SOC_SERIES_RISCV_VIRT=y
CONFIG_SOC_RISCV_VIRT=y
CONFIG_BOARD_QEMU_RISCV64CHERI_ZCHERIPURECAP=y
CONFIG_PRIVILEGED_STACK_SIZE=4096
CONFIG_CONSOLE=y
CONFIG_SERIAL=y
CONFIG_UART_CONSOLE=y
CONFIG_STACK_SENTINEL=y
CONFIG_QEMU_ICOUNT_SHIFT=6
CONFIG_XIP=n
CONFIG_RISCV_PMP=n

#compile for cheri purecap for codasip core codasip-a730 with 0.9.5 spec
CONFIG_CHERI=y
CONFIG_ISR_TABLE_USE_SYMBOLS=y
CONFIG_RISCV_ISA_ZCHERIPURECAP_ABI=y
```
