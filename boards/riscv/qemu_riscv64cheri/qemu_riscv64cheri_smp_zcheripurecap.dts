/* SPDX-License-Identifier: Apache-2.0 */
/* Modified for CHERI 2025 by University of Birmingham */

/dts-v1/;

#include <virt.dtsi>

/ {
	chosen {
		zephyr,console = &uart0;
		zephyr,shell-uart = &uart0;
		zephyr,sram = &ram0;
	};
};

&uart0 {
	status = "okay";
};
