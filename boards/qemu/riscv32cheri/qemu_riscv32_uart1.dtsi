/* Modified for CHERI 2025 by University of Birmingham & Durham University */
/* SPDX-License-Identifier: Apache-2.0 */

/ {
	uart1: uart@10002000 {
		interrupts = < 0x0c 1 >;
		interrupt-parent = < &plic >;
		clock-frequency = < 0x384000 >;
		reg = < 0x10002000 0x100 >;
		compatible = "ns16550";
		reg-shift = < 0 >;
	};
};
