/* SPDX-License-Identifier: Apache-2.0 */
/* Modified for CHERI 2025 by University of Birmingham */

/dts-v1/;

#include <qemu/virt-riscv32.dtsi>
#include "qemu_riscv32_uart1.dtsi"

/ {
	chosen {
		zephyr,console = &uart0;
		zephyr,shell-uart = &uart0;
		zephyr,sram = &ram0;
	};
};

&uart0 {
	status = "okay";
};
