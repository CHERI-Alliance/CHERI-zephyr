/* Copyright (c) 2019 BayLibre SAS */
/* Modified for CHERI 2024 by University of Birmingham */
/* SPDX-License-Identifier: Apache-2.0 */

/dts-v1/;

#include <qemu/virt-riscv64.dtsi>
#include "qemu_riscv64_uart1.dtsi"

/ {
	chosen {
		zephyr,console = &uart0;
		zephyr,shell-uart = &uart0;
		zephyr,sram = &ram0;
	};
};

&uart0 {
	status = "okay";
};
