## boards/codasip/hobgoblin_riscv32cheri/Kconfig
```kconfig
# SPDX-License-Identifier: Apache-2.0
# Copyright (c) 2026 Added to support CHERI 2026, University of Birmingham

config BOARD_HOBGOBLIN_RISCV32CHERI
	bool "HOBGOBLIN RISCV32CHERI target"

config BOARD_HOBGOBLIN_RISCV32CHERI_ZCHERIPURECAP
	bool "HOBGOBLIN RISCV32CHERI ZCHERIPURECAP target"
```

## boards/codasip/hobgoblin_riscv32cheri/Kconfig.defconfig
```kconfig
# SPDX-License-Identifier: Apache-2.0
# Copyright (c) 2026 Added to support CHERI 2026, University of Birmingham

if BOARD_HOBGOBLIN_RISCV32CHERI || BOARD_HOBGOBLIN_RISCV32CHERI_ZCHERIPURECAP

config BUILD_OUTPUT_BIN
	default n

config HAS_COVERAGE_SUPPORT
	default y

endif
```

## boards/codasip/hobgoblin_riscv32cheri/Kconfig.hobgoblin_riscv32cheri
```kconfig
# SPDX-License-Identifier: Apache-2.0
# Copyright (c) 2026 Added to support CHERI 2026, University of Birmingham

config BOARD_HOBGOBLIN_RISCV32CHERI
	select SOC_HOBGOBLIN_V739_RISCV32CHERI
```

## boards/codasip/hobgoblin_riscv32cheri/board.yml
```yaml
boards:

  - name: hobgoblin_riscv32cheri
    full_name: codasip v739 hobgoblin hardware platform for riscv32cheri
    vendor: codasip
    socs:
      - name: hobgoblin_v739_riscv32cheri
  - name: hobgoblin_riscv32cheri_zcheripurecap
    full_name: codasip v739 hobgoblin hardware platform for riscv32cheri_zcheripurecap
    vendor: codasip
    socs:
      - name: hobgoblin_v739_riscv32cheri
```

## boards/codasip/hobgoblin_riscv64cheri/Kconfig
```kconfig
# SPDX-License-Identifier: Apache-2.0
# Copyright (c) 2026 Added to support CHERI 2026, University of Birmingham

config BOARD_HOBGOBLIN_RISCV64CHERI
	bool "HOBGOBLIN RISCV64CHERI target"

config BOARD_HOBGOBLIN_RISCV64CHERI_SMP
	bool "HOBGOBLIN RISCV64CHERI SMP target"

config BOARD_HOBGOBLIN_RISCV64CHERI_ZCHERIPURECAP
	bool "HOBGOBLIN RISCV64CHERI ZCHERIPURECAP target"

config BOARD_HOBGOBLIN_RISCV64CHERI_SMP_ZCHERIPURECAP
	bool "HOBGOBLIN RISCV64CHERI SMP ZCHERIPURECAP target"
```

## boards/codasip/hobgoblin_riscv64cheri/Kconfig.defconfig
```kconfig
# SPDX-License-Identifier: Apache-2.0
# Copyright (c) 2026 Added to support CHERI 2026, University of Birmingham

if BOARD_HOBGOBLIN_RISCV64CHERI || BOARD_HOBGOBLIN_RISCV64CHERI_SMP || BOARD_HOBGOBLIN_RISCV64CHERI_ZCHERIPURECAP || BOARD_HOBGOBLIN_RISCV64CHERI_SMP_ZCHERIPURECAP

config BUILD_OUTPUT_BIN
	default n

config HAS_COVERAGE_SUPPORT
	default y

endif
```

## boards/codasip/hobgoblin_riscv64cheri/Kconfig.hobgoblin_riscv64cheri_smp
```kconfig
# SPDX-License-Identifier: Apache-2.0
# Copyright (c) 2026 Added to support CHERI 2026, University of Birmingham

config BOARD_HOBGOBLIN_RISCV64CHERI_SMP
	select SOC_HOBGOBLIN_X730_MP4_RISCV64CHERI
```

## boards/codasip/hobgoblin_riscv64cheri/board.yml
```yaml
boards:

  - name: hobgoblin_riscv64cheri
    full_name: codasip x730-mp4 hobgoblin hardware platform for riscv64cheri
    vendor: codasip
    socs:
      - name: hobgoblin_x730_mp4_riscv64cheri
        variants:
          - name: smp
  - name: hobgoblin_riscv64cheri_smp
    full_name: codasip x730-mp4 hobgoblin hardware platform for riscv64cheri_smp
    vendor: codasip
    socs:
      - name: hobgoblin_x730_mp4_riscv64cheri
  - name: hobgoblin_riscv64cheri_zcheripurecap
    full_name: codasip x730-mp4 hobgoblin hardware platform for riscv64cheri_zcheripurecap
    vendor: codasip
    socs:
      - name: hobgoblin_x730_mp4_riscv64cheri
        variants:
          - name: smp
  - name: hobgoblin_riscv64cheri_smp_zcheripurecap
    full_name: codasip x730-mp4 hobgoblin hardware platform for riscv64cheri_smp_zcheripurecap
    vendor: codasip
    socs:
      - name: hobgoblin_x730_mp4_riscv64cheri
```

## boards/codasip/hobgoblin_riscv64cheri/hobgoblin_riscv64cheri_defconfig
```kconfig
# SPDX-License-Identifier: Apache-2.0
# Copyright (c) 2026 Added to support CHERI 2026, University of Birmingham

CONFIG_BOARD_HOBGOBLIN_RISCV64CHERI=y
CONFIG_PRIVILEGED_STACK_SIZE=2048
CONFIG_CONSOLE=y
CONFIG_SERIAL=y
CONFIG_UART_CONSOLE=y
CONFIG_STACK_SENTINEL=y
CONFIG_XIP=n
CONFIG_RISCV_PMP=n #not enabled in the codasip hardware

CONFIG_MINIMAL_LIBC=y
CONFIG_ARCH_STACKWALK=n
```

## boards/codasip/hobgoblin_riscv64cheri/hobgoblin_riscv64cheri_smp_defconfig
```kconfig
# SPDX-License-Identifier: Apache-2.0
# Copyright (c) 2026 Added to support CHERI 2026, University of Birmingham


CONFIG_BOARD_HOBGOBLIN_RISCV64CHERI_SMP=y
CONFIG_PRIVILEGED_STACK_SIZE=2048
CONFIG_CONSOLE=y
CONFIG_SERIAL=y
CONFIG_UART_CONSOLE=y
CONFIG_STACK_SENTINEL=y
CONFIG_XIP=n
CONFIG_RISCV_PMP=n  #not enabled in the codasip hardware

CONFIG_MINIMAL_LIBC=y
CONFIG_ARCH_STACKWALK=n

CONFIG_SMP=y
CONFIG_MP_MAX_NUM_CPUS=4
CONFIG_QEMU_ICOUNT=n
CONFIG_IDLE_STACK_SIZE=1024
CONFIG_TICKET_SPINLOCKS=y
```

## boards/codasip/hobgoblin_riscv64cheri/hobgoblin_riscv64cheri_smp_zcheripurecap_defconfig
```kconfig
# SPDX-License-Identifier: Apache-2.0
# Copyright (c) 2026 Added to support CHERI 2026, University of Birmingham

CONFIG_BOARD_HOBGOBLIN_RISCV64CHERI_SMP_ZCHERIPURECAP=y
CONFIG_PRIVILEGED_STACK_SIZE=2048
CONFIG_CONSOLE=y
CONFIG_SERIAL=y
CONFIG_UART_CONSOLE=y
CONFIG_STACK_SENTINEL=y
CONFIG_XIP=n
CONFIG_RISCV_PMP=n  #not enabled in the hardware

CONFIG_MINIMAL_LIBC=y
CONFIG_ARCH_STACKWALK=n

CONFIG_SMP=y
CONFIG_MP_MAX_NUM_CPUS=4
#CONFIG_QEMU_ICOUNT=n

CONFIG_IDLE_STACK_SIZE=2048
CONFIG_TICKET_SPINLOCKS=y

#compile for cheri purecap
CONFIG_MAIN_STACK_SIZE=4096
CONFIG_CHERI=y
CONFIG_ISR_TABLE_USE_SYMBOLS=y
CONFIG_RISCV_ISA_ZCHERIPURECAP_ABI=y
#hardware cores boot in hybrid mode so
#we need to build with hybrid, and the
#boot code switches it to purecap
CONFIG_RISCV_ISA_ZCHERIHYBRID=y
```

## boards/qemu/riscv32cheri/Kconfig
```kconfig
# Copyright (c) 2024 Antmicro <www.antmicro.com>
# Modified to support CHERI 2025, University of Birmingham
# SPDX-License-Identifier: Apache-2.0

config BOARD_QEMU_RISCV32CHERI
	bool "QEMU RISCV32CHERI target"
	select QEMU_TARGET

config BOARD_QEMU_RISCV32CHERI_PURECAP
	bool "QEMU RISCV32CHERI PURECAP target"
	select QEMU_TARGET

config BOARD_QEMU_RISCV32CHERI_SMP
	bool "QEMU RISCV32CHERI SMP target"
	select QEMU_TARGET

config BOARD_QEMU_RISCV32CHERI_SMP_PURECAP
	bool "QEMU RISCV32CHERI SMP PURECAP target"
	select QEMU_TARGET

config BOARD_QEMU_RISCV32CHERI_ZCHERIPURECAP
	bool "QEMU RISCV32CHERI ZCHERIPURECAP target"
	select QEMU_TARGET

config BOARD_QEMU_RISCV32CHERI_SMP_ZCHERIPURECAP
	bool "QEMU RISCV32CHERI SMP ZCHERIPURECAP target"
	select QEMU_TARGET
```

## boards/qemu/riscv32cheri/board.yml
```yaml
boards:

  - name: qemu_riscv32cheri
    full_name: QEMU Emulation for RISCV32cheri
    vendor: qemu
    socs:
      - name: qemu_virt_riscv32
        variants:
          - name: smp
  - name: qemu_riscv32cheri_smp
    full_name: QEMU Emulation for RISCV32cheri_smp
    vendor: qemu
    socs:
      - name: qemu_virt_riscv32
  - name: qemu_riscv32cheri_purecap
    full_name: QEMU Emulation for RISCV32cheri_purecap
    vendor: qemu
    socs:
      - name: qemu_virt_riscv32
        variants:
          - name: smp
  - name: qemu_riscv32cheri_smp_purecap
    full_name: QEMU Emulation for RISCV32cheri_smp_purecap
    vendor: qemu
    socs:
      - name: qemu_virt_riscv32
  - name: qemu_riscv32cheri_zcheripurecap
    full_name: QEMU Emulation for RISCV32cheri_zcheripurecap
    vendor: qemu
    socs:
      - name: qemu_virt_riscv32
        variants:
          - name: smp
  - name: qemu_riscv32cheri_smp_zcheripurecap
    full_name: QEMU Emulation for RISCV32cheri_smp_zcheripurecap
    vendor: qemu
    socs:
      - name: qemu_virt_riscv32
```

## boards/qemu/riscv32cheri/qemu_riscv32cheri_smp_defconfig
```kconfig
# SPDX-License-Identifier: Apache-2.0
# Modified for CHERI 2025 by Birmingham University


CONFIG_BOARD_QEMU_RISCV32CHERI_SMP=y
CONFIG_PRIVILEGED_STACK_SIZE=2048
CONFIG_CONSOLE=y
CONFIG_SERIAL=y
CONFIG_UART_CONSOLE=y
CONFIG_STACK_SENTINEL=y
CONFIG_XIP=n
CONFIG_RISCV_PMP=y

CONFIG_MINIMAL_LIBC=y
CONFIG_ARCH_STACKWALK=n

CONFIG_SMP=y
CONFIG_MP_MAX_NUM_CPUS=2
CONFIG_QEMU_ICOUNT=n
CONFIG_IDLE_STACK_SIZE=1024
CONFIG_TICKET_SPINLOCKS=y
```

## boards/qemu/riscv32cheri/qemu_riscv32cheri_smp_zcheripurecap_defconfig
```kconfig
# SPDX-License-Identifier: Apache-2.0
# Modified for CHERI 2025 by Birmingham University

CONFIG_BOARD_QEMU_RISCV32CHERI_SMP_ZCHERIPURECAP=y
CONFIG_PRIVILEGED_STACK_SIZE=2048
CONFIG_CONSOLE=y
CONFIG_SERIAL=y
CONFIG_UART_CONSOLE=y
CONFIG_STACK_SENTINEL=y
CONFIG_XIP=n
CONFIG_RISCV_PMP=n  #not enabled in qemu

CONFIG_MINIMAL_LIBC=y
CONFIG_ARCH_STACKWALK=n

CONFIG_SMP=y
CONFIG_MP_MAX_NUM_CPUS=2
CONFIG_QEMU_ICOUNT=n

CONFIG_IDLE_STACK_SIZE=1024
CONFIG_TICKET_SPINLOCKS=y

#compile for cheri purecap
CONFIG_CHERI=y
CONFIG_ISR_TABLE_USE_SYMBOLS=y
CONFIG_RISCV_ISA_ZCHERIPURECAP_ABI=y
```

## boards/qemu/riscv64cheri/Kconfig
```kconfig
# Copyright (c) 2024 Antmicro <www.antmicro.com>
# Modified to support CHERI 2025, University of Birmingham
# SPDX-License-Identifier: Apache-2.0

config BOARD_QEMU_RISCV64CHERI
	bool "QEMU RISCV64CHERI target"
	select QEMU_TARGET

config BOARD_QEMU_RISCV64CHERI_PURECAP
	bool "QEMU RISCV64CHERI PURECAP target"
	select QEMU_TARGET

config BOARD_QEMU_RISCV64CHERI_SMP
	bool "QEMU RISCV64CHERI SMP target"
	select QEMU_TARGET

config BOARD_QEMU_RISCV64CHERI_SMP_PURECAP
	bool "QEMU RISCV64CHERI SMP PURECAP target"
	select QEMU_TARGET
```

## boards/qemu/riscv64cheri/Kconfig.defconfig
```kconfig
# Copyright (c) 2024 Antmicro <www.antmicro.com>
# Modified to support CHERI 2025, University of Birmingham
# SPDX-License-Identifier: Apache-2.0

if BOARD_QEMU_RISCV64CHERI || BOARD_QEMU_RISCV64CHERI_PURECAP || BOARD_QEMU_RISCV64CHERI_SMP || BOARD_QEMU_RISCV64CHERI_SMP_PURECAP

config BUILD_OUTPUT_BIN
	default n

config HAS_COVERAGE_SUPPORT
	default y

config QEMU_ICOUNT_SHIFT
	default 6 if QEMU_ICOUNT

endif # BOARD_QEMU_RISCV64CHERI
```

## boards/qemu/riscv64cheri/board.yml
```yaml
boards:
- name: qemu_riscv64cheri
  full_name: QEMU Emulation for RISCV64cheri
  vendor: qemu
  socs:
    - name: qemu_virt_riscv64
      variants:
        - name: smp
- name: qemu_riscv64cheri_smp
  full_name: QEMU Emulation for RISCV64cheri
  vendor: qemu
  socs:
    - name: qemu_virt_riscv64
- name: qemu_riscv64cheri_purecap
  full_name: QEMU Emulation for RISCV64cheri_purecap
  vendor: qemu
  socs:
    - name: qemu_virt_riscv64
      variants:
        - name: smp
- name: qemu_riscv64cheri_smp_purecap
  full_name: QEMU Emulation for RISCV64cheri
  vendor: qemu
  socs:
    - name: qemu_virt_riscv64
```

## boards/qemu/riscv64cheri/qemu_riscv64cheri_purecap_defconfig
```kconfig
# SPDX-License-Identifier: Apache-2.0
# Modified for CHERI 2025 by University of Birmingham

CONFIG_BOARD_QEMU_RISCV64CHERI_PURECAP=y
CONFIG_PRIVILEGED_STACK_SIZE=2048
CONFIG_CONSOLE=y
CONFIG_SERIAL=y
CONFIG_UART_CONSOLE=y
CONFIG_STACK_SENTINEL=y
CONFIG_XIP=n
CONFIG_RISCV_PMP=n

CONFIG_MINIMAL_LIBC=y
CONFIG_ARCH_STACKWALK=n


#compile for cheri purecap
CONFIG_MAIN_STACK_SIZE=4096
CONFIG_CHERI=y
CONFIG_ISR_TABLE_USE_SYMBOLS=y
```

## cmake/toolchain/llvm-cheri/Kconfig
```kconfig
# Copyright (c) 2023 Intel Corporation
# SPDX-License-Identifier: Apache-2.0
# Added to support CHERI 2023, University of Birmingham

#set default to use llvm lld linker

choice LLVM_LINKER
	prompt "LLVM Linker"
	depends on "${ZEPHYR_TOOLCHAIN_VARIANT}" = "llvm-cheri"
	default LLVM_USE_LLD

config LLVM_USE_LD
	bool "GNU ld"
	help
	  Use binutils ld linker with llvm-cheri/clang.

config LLVM_USE_LLD
	bool "LLVM lld"
	help
	  Use LLVM built-in lld linker with llvm-cheri/clang.

endchoice

config TOOLCHAIN_LLVM_SUPPORTS_THREAD_LOCAL_STORAGE
	depends on RISCV
	def_bool y
	select TOOLCHAIN_SUPPORTS_THREAD_LOCAL_STORAGE

config TOOLCHAIN_LLVM_SUPPORTS_GNU_EXTENSIONS
	def_bool y
	select TOOLCHAIN_SUPPORTS_GNU_EXTENSIONS

#set default to not use CHERI configurations unless specified

config CHERI
	bool "Build for CHERI architectures"
	default n
	help
	  This option is used by the python script gen_isr_tables.py to read
	  in a different intList structure compatible with the CHERI architecture
	  and must be set to y if building for CHERI.


config ISR_TABLE_USE_SYMBOLS
	bool "Use symbols in the interrupt table instead of addresses"
	default n
	help
	  When building for CHERI the interrupt table must not contain fixed
	  addresses, so this must be set to y if building for CHERI. It is used
	  in gen_isr_tables.py sw_isr_table.h intc_plic.c riscv_machine_timer.c
	  uart_ns16550.c
	  This option can also be used for non CHERI builds.

config RISCV_ISA_ZCHERIPURECAP_ABI
	bool "Build for purecap CHERI RISC-V 0.9.5 spec"
	default n
	help
	  When building for CHERI this is used to select the CHERI RISC-V 0.9.5
	  spec otherwise the default cambridge v8.0 spec is used

config CHERI_MEM_SLAB_RELAX_BLK_BOUNDS
	bool "relax bounds overlap for internal blocks of a slab"
	default n
	help
	  When building for CHERI this is used to select allowing bounds overlap
	  for internal slab blocks so the number of blocks still fit in the slab size

config CHERI_MEM_SLAB_NUM_BLKS_REDUCE
	bool "reduce the number of available blocks if they can't fit in the slab with exact bounds"
	default n
	help
	  When building for CHERI this is used to select the option of reducing the
	  number of available blocks in a slab to maintin exact bounds when they
	  don't fit in the slab after CHERI rounding
```

## cmake/toolchain/llvm-cheri/Kconfig.defconfig
```kconfig
# Copyright (c) 2025 University of Birmingham
#
# SPDX-License-Identifier: Apache-2.0

config CHERI
	default n

config ISR_TABLE_USE_SYMBOLS
	default n
```
