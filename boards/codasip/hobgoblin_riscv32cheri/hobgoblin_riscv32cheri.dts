/* SPDX-License-Identifier: Apache-2.0 */
/* Copyright (c) 2026 Added to support CHERI 2026, University of Birmingham */

/dts-v1/;

/* include cpu set up */
#include <codasip/cpu-v739-cheri.dtsi>

/* include soc and board components */
/* clic,clint,uart0,soc */
/* ddr */
#include <codasip/hobgoblin-vcu118-for-v739.dtsi>

/ {
	model = "Codasip Hobgoblin2 VCU118 V739";
	compatible = "codasip,hobgoblin2-vcu118";
	chosen {
		zephyr,console = &uart0;
		zephyr,shell-uart = &uart0;
		zephyr,sram = &ddr;
	};
};

&uart0 {
	status = "okay";
};
